//#include <Arduino.h>
#include <WiFi.h>
#include <ESPAsyncWebServer.h>
#include <Arduino_JSON.h>

// wifi credentials
const char* ssid = "etta-itv";
const char* password = "etta1234";
//const char* ssid = "Rede udi";
//const char* password = "1j4b7i2g$4";
// Set web server port number to 80
//WiFiServer server(80);
AsyncWebServer server(80);
AsyncEventSource events("/events");

//Define Serial 2 to comunicate with Arduino UNO
#define RXp2 16
#define TXp2 17

#define IMPRIME_SERIAL 0

TaskHandle_t TaskInternetManagerHandle;
TaskHandle_t TaskSerialManagerHandle;
 
// Structure da mensagem para enviar para ESP32
#define HEADER_MSG 0xCA
#define FOOTER_MSG 0xFEFE
typedef struct struct_message {
  uint8_t header;
  float turb_v;   //turbidez voltage
  float turb_ntu; //turbidez 0 a 10000 NTU
  float temp;     //temperature
  float cond_v;   //condutividade voltage
  float cond_tds; //condutividade tds
  uint16_t footer;
} struct_message;
struct_message inputframe;

#ifndef LED_BUILTIN
  #define LED_BUILTIN 2 // Specify the on which is your LED
#endif
uint8_t blinkvalue=0;


unsigned long currentTime = millis();
unsigned long previousTime = 0; 
const long timeoutTime = 2000;

uint8_t count=0;
// Auxiliar variables to store the current output state
String output26State = "off";
String output27State = "off";
const int output26 = 2;
const int output27 = 27;

//Water Quality Indice (WQI)
//Turbidez
#define TURB_NTU_MAX 3000.0
#define TURB_NTU_MIN 1500.0
//Condutividade
#define TURB_TDS_MAX 4000.0
#define TURB_TDS_MIN 50.0

float fwaterquality = 0;


void TaskInternetManager ( void * pvParameters );

// Variable to store the HTTP request
String header;

uint8_t ReadValue=0; 
 
JSONVar board;

// TELA HTML ---------------------------------------------------------
const char index_html[] PROGMEM = R"rawliteral(
  
<!DOCTYPE HTML><html>
</head>
<body>
<head>
  <title>ETTAITV </title>
  <meta name="viewport" content="width=device-width, initial-scale=1">
  <link rel="stylesheet" href="https://use.fontawesome.com/releases/v5.7.2/css/all.css" integrity="sha384-fnmOCqbTlWIlj8LyTjo7mOUStjsKC4pOpQbqyi7RrhN7udi9RwhKkMHpvLbHG9Sr" crossorigin="anonymous">
  <link rel="icon" href="data:,">
  <style>
    html {font-family: Arial; display: inline-block; text-align: center;}
    p {  font-size: 1.2rem;}
    body {  margin: 0;}
    .topnav { overflow: hidden; background-color: #081152; color: white; font-size: 1.7rem; }
    .content { padding: 20px; background-color: white; }
    .card { background-color: white; box-shadow: 2px 2px 12px 1px rgba(140,140,140,.5); }
    .cards { max-width: 700px; margin: 0 auto; display: grid; grid-gap: 2rem; grid-template-columns: repeat(auto-fit, minmax(300px, 1fr)); }
    .reading { font-size: 2.8rem; }
    .packet { color: #bebebe; }
    .card.temp { color: #fd7e14; }
    .card.turb { color: #1b78e2; }
    .card.cond { color: #ff0000; }

	figure {
	  border: 1px #081152 solid;
	  padding: 4px;
	  margin: auto;
	  display: block;
	  margin-top: 1em;
	  margin-bottom: 1em;
	  margin-left: 10px;
	  margin-right: 10px;
	}
</style>

</head>
<body>

  <div class="topnav">
  <!-- <figure>
  <img src="ettaitv.png" alt="MariaBeatriz" style="width:85%">  
  </figure> -->
  <figure>
  <img src="data:image/png;base64,iVBORw0KGgoAAAANSUhEUgAABNAAAAHDCAIAAABqKnAgAAAAAXNSR0IArs4c6QAAAARnQU1BAACxjwv8YQUAAAAJcEhZcwAADsMAAA7DAcdvqGQAAHJtSURBVHhe7d0HeBPl48Dxv7RNf5Q2CV1AN6Psvffe0DZp2HsjCIgIiChbQZClCCpLZM8y3IiKgCCrBdy4BUT2Hp3833JpKNcCHRl36fd9Po8PJNfkcomQL3f33v/9r2A0AAAAAABWR3ACAAAAAGyC4AQAAAAA2ATBCQAAAACwCYITAAAAAGATBCcAAAAAwCYITgAAAACATRCcAAAAAACbIDgBAAAAADZBcAIAAAAAbILgBAAAAADYBMEJAAAAALAJghMAAAAAYBMEJwAAAADAJghOAAAAAIBNEJwAAAAAAJsgOAEAAAAANkFwAgAAAABsguAEFEmf4RYAAABAbQhOKJbRvaDRTWtw9YpKpY0Sv3bXGzMs5qQITgAAAKgfwQml0OiMIiy9/DuWKD+oXrMxXXvPGj1++fTXNy14+4O3F38k/jtrzuYXJ7zf7+k3WkVOKlNlSMEiXUSCCrLHAQAAAKAQBCcczF1vzO9jKlK0VxvDpHkLtv/y6+mkpOR7TxrJycln/7uyftOeHv1mh5bq5+nX0dl2frKHEwAAAOpHcMJh3LQGL/+O3frM/nrf9+cvXE1KSjLXZHZGcnLK1as3j53448UJ7xcK7eHqGSV7FgAAAACOQnDCAURqlqw4eNK0NSd/PWMOR2uMCxevvb3kk9qNR2v06j/bkz2cAAAAUD+CE3blXjBaX7jzy1NW37x115yJ1h6JiUnvrdxVrOwA2VOrDMEJAAAA9SM4YT8unlG9Bsz76+/zyckp5jq02bhw8dqM1zd5eEe7q7TcCE4AAACoH8EJe3DXG0NL9Vu55svExJycqJmzkZKSsm//D/WbveCmU+FMtgQnAAAA1I/ghM2564z1m429du2WOQTtO27dvtuz35z83ibZWgEAAACwNYIzT3PXR7t4Rbl6RaVem8Tb5OHTQSJ+7V4w2lVrEPdqdLmafUf8+KgXll51UG1KIyEhcdG7HxXw7SBbN0VjDycAAADUj+DMWzQ6g4jMQqE9ajYY1bP/3CnT161e+9Vnu2Jjj/1+8tcz//53+ex9f/517sT3f32157t1m/bMmrdlwNA3G7UYF1Kyr3iELB6eKhbz9OtYr9nYhe9+ePdugrn8HDpWrf1SX6SLak7pJDgBAACgfgRnnpB6jRC90S+4u7Hzqzs+PPiIo1vTT+STyaQ+8fEJ+/b/MHjYWwHFepsfU/4s5icSQduj35zjJ/40/6Rixld7TugKd5attkIRnAAAAFA/gtPJpRagtym6y/TPPo89d/5q7qeHTUlJuXL15qEjJ4c8u0hXqLNGZxRP4eIZKZ6rat2Rk19Ze+DgzxcuXhOLmX9ASUO8/E0x+7z8O6XfRApFcAIAAED9CE6nJTrQ069jt76v7zvwo7m3rD1+/+Ps6BeXDx/17opVX/zw0z/xCYnmO5Q95r213U2rwnlrAQAAALUhOJ2Te0Fj5dojfvz5lLmxGOlGSkrKgCFvZjwkWFnYwwkAAAD1IzidkItn1PTXN165ctMcWIwM49q1W9XqjlR0cxKcAAAAUD+C06mIgipSrNeGzXtzf66m04/DR3/1De4m24AKQnACAABA/QhOp+Lp13HnrjhzUTGeNKZMX6fcnZwEJwAAANSP4HQeblpDzPYD5pZiZGGcO38lKLyvaq7MCQAAAKgNwekk3PXGMeOXJyUlm1uKkbWx/cODHj4m2cZUBDIYAAAA6kdwOomyVYeYE4qRnXHnTkKlWsNlG1MRCE4AAACoH8HpDFy9ombPjzEnFCOb491ln7ppo2Sb1PEITgAAAKgfwekMfAK7/nPqgrmfGNkct27dLVtliGyTOh7BCQAAAPUjOJ1B87Yvm+OJkaMx6ZU1sk3qeAQnAAAA1I/gdAajxy83lxMjR+PAwZ9dvRR2VC3BCQAAAPUjOJ3B3De3mcuJkaNx48adYmUHKOuanAQnAAAA1I/gdAZTpq8zlxMjp2Psy+9pdAbZhnUkghMAAADqR3A6g049XjNnEyOn40jsr8q6ICfBCQAAAPUjONXEXW900xnEfz39OhQs0sUvuLtvUHetf6eiZQdcv37LXE6MHI3rN24XCush2+AAAAAAcoPgVA0Xz6jg8D6Dhy3c8dHB3/84e+vW3bt3E4QrV28eOnLy6lWCM1dDbMkK1YfJtrkjsYcTAAAA6kdwKp2bNiqwRO8JU1eLqrx+/bY5jxjWHklJya2jJso2viMRnAAAAFA/glO53PXGggFdhj33zpl/L5qriGGzkZJyb8iIRRqdYiaqJTgBAACgfgSncgWX7Pv9D3+niBJi2GVMe22Dq5diJqolOAEAAKB+BKcSueuj6zUd88vJ0+YSYthlLF7+qatXlOy9AAAAAJBjBKfiuOuNZaoMOXv2sjmDGPYa6zftcdOyhxMAAACwGoJTcQoGdv3l1zPmBmLYcXz2eSzncAIAAABWRHA+gbveqNEZXLVRrl5RLp6RaVJ/K24Ud4kFZD+SG+IBJ7+61hxADPuOHR8ddNOxhxMAAACwGoLzIaIehQK+HXyDuxUrO7BavZFtDJO69Zk9cvTiya+snTFr4+w3YmbN3SJ+MWHq6hGjF3ft9XqbqEnV6o4sXm6gf0gPL/9O4kE0uUhQ/5Dup04zJ61jxup1X7lySC0AAABgPQRnKo3O+JRHhJdfx2ZtXpq7YFts3G+XLl2/dftufHxiUlLyY+aJFXeJBcRit2/fvXL15o8/nRLR0mfQ/LDS/V08o/IViLy//zOr/SkWHjN+ufmhGXYfbyza4eIVKXtTHIbgBAAAgPrl6eAUgZffO7pGg1FTp6/76usT/527kpycbI6P3A3Rn7+cPL1tx4Hxk1Y2avmiX3B3tywcfOvhbTrw7U/mh2DYfbw8eRWTBgEAAABWlEeDU7Rf4aK9uvedvXf/D0lJ1onMx4yz/11eu353z35zyld/xjuwq7s+88NudYU7/3PqgvlnGPYdKSkp4vOQ8R8FxC2CRpdO6i0PLWMTBCcAAADUL88FpwgGrX+nidPWnL9w1Vr7M7M4RNLcuRP/37nLMdv3d+r+mm9Qt3weES6ekZb49A/uLtbKvDTDviMxMalBi3HiXXDTGvIViHgqf4ToTL+QHpVqDW/Q/IX20VNEjho6vRLRYWrj1uPLVB2qK9zZ1StKLOaqNdikPwlOAAAAqF8eCk5RBZ5+HZ8bu0QJFx0R8Xnl6s0jsb+uXvfV6BeXtWg/oWiZ/gHFe1+4eM28BMO+486d+OZtXurU47XX5myO2XHg0JGTp05fuH7jdkJCouwkXvHb+PhE8fb9/MupnV/EvbFwR4duM4LD+4pSzbiDNOcITgAAAKhfXglOjc5Yocaw3XtOmKNBeUMEz+9/nE1MTDL/nmHfIaIyNwdX37p1d+WaL1u0n6Av0tk62UlwAgAAQP3yRHCKAOg7+I2rV2+Z44DBsM1ISEw6dfrCoKELrDD5EMEJAAAA9XP+4PT07Tjl1bV37iaYm4DBsPFITk7Zs+/71pGTcrWrk+AEAACA+jl/cM6eH2PuAAbDvmPC1FW6wp1lH8isIjgBAACgfs4dnMZJr6zhrEiGo0ZSUvKuL495+HTI8MnMAoITAAAA6ue0wanRGVtGTLx16675uz+D4YiRkpKy95sfQkv1k30+n4zgBAAAgPo5bXAGlehz9r/L5m/9DIZDx8efHsn2sbUEJwAAANTPOYPTTWvg1E2GckZKSsraDbvds9WQBCcAAADUzzmDs0jRXv+evWT+ss9gKGDcvhNv7PyqRpfleWsJTgAAAKifEwanu944cdoa89d8BkMx4/KVGyE5OJkTAAAAUC0nDE5P/46//HrG/B2fwVDSeG32JhevKNknNnPs4QQAAID6OWFwhpXuf/XqTfMXfAZDSeP0v5cKhfWUfWIzR3ACAABA/ZwtON310Q1bjOPamwzFjhcnrHDXZ+FMToITAAAA6udswanRGfsOmp+SkmL+ds9gKGx898NfBXw7yD63mSA4AQAAoH7OFpyuXlEvvLzC/NWewVDeuHr1Zljp/rLPLQAAAOCUnDA4X5q00vzVnsFQ3khJSencc6ab1iD76MqxhxMAAADq52zBKb7Hjxq3zPzVnsFQ5Fiy/DM37ZPmqiU4AQAAoH7Odw6noffAeZzDyVDyOP7dn/m9TbKPrhzBCQAAAPVztuAU6jUdm5DALLUM5Y4rV2/6h/aQfW7lCE4AAAConxMGZ1jp/teu3TJ/tWcwlDeSkpKePG8QwQkAAAD1c8Lg1Bfu/Odf/5m/2jMYihylKz8t+9zKEZwAAABQPycMTne98d1ln5q/1zMYihxlKg+RfW7lCE4AAACon3MGZ+VaI27fiTd/tWcwlDcITgAAAOQFThicgqtX1KaYfeav9gyGwkZyckqxsgNkH1o5ghMAAADq55zBKdRpMiYxkblqGUocN2/eKVK0l+wTK0dwAgAAQP2cNjg1OuOI5xcnJSWbv+MzGIoZf/1z3su/o+wTK0dwAgAAQP2cNjgFT98Oy97fmZxMczKUNT7+9IhGZ5R9XOUITgAAAKifMwen4OIZtWT5Z8nJKeZv+gyGAsakaWtcPaNkn1U5ghMAAADq5+TBKXj6dXx6+MLrN26bv+wzGA4dSUnJzdq+zB5OAAAA5AXOH5yC+HJfsebwLdv237p11/ytn8Fw0Lh0+XpQid6yjygAAADglPJEcEpcvaJKVx7y5e7jCQmJKSkcZMtwzPjl1zMF/DrIPpyZYA8nAAAA1C8PBafgrjf+z9sUXmFQ30HzN2zec+78FXMEMBj2Ggve/sA9wyczEwQnAAAA1C9vBaeFRmd09YryD+nesMULz49b9t7KXV/uPh534o8//vzv3Pmr12/cvn0nPiEhMSEhKTExid2hDGsN8Ymq3Wi0e1ZikuAEAACA+uXR4EzPXW901RqeKhDxf/9r5+IZJX6rLdQ5pFS/SjVHVK79bPV6I5u1e/nKlRvmYmAwcjFi43539XrS/LQSghMAAADqR3Bmzl2fGqKSwmE9mW2IYZUxadoaN23WghMAAABQP4LzCUR51mjwXFJSsrkYGIycjoSExMq1Rsg+YI/EHk4AAACoH8H5BO56o7Hzq+ZiYDByMWK27xcfJ9kH7JEITgAAAKgfwfkEGp1h6MhF5mJgMHI6bt26W6Xus1maLkhCcAIAAED9CM4ncNMaxox/zxwNDEZOx9d7v8vvbZJ9uh6H4AQAAID6EZxPoNEZ57yx1RwNDEaORlJSUv3mY7NxPK1AcAIAAED9CM4nIDgZuR9r1u8WHyTZR+sJCE4AAACoH8H5BPeDc5u5GxiM7I/bt+Or1Rsp+1wBAAAAeQHB+QQiOKfOWG9OBwYj+2Ni6rU3DbLP1ZOxhxMAAADqR3A+gUiFEaMXm9OBwcjm+P6Hv/SFO8s+VFlCcAIAAED9CM4n0OiMnXrOMtcDg5GdcfPmnTaGydm4FAoAAADgXAjOJ3DXG5u0Hp+cnGJuCAYjy2P6rI05OZhWQqYCAABA/QjOJwsr3e/O3QRzQzAYWRuHj5z0D+kh+ywBAAAAeQrB+WT6gC4XL103ZwSDkYVx5t9LxcoOyN6FN2XYwwkAAAD1IzifzNUj4rff/zWXBIPxpJGcnGzs8qp7wVzUpkBwAgAAQP0Izidz8Yz69tAv5phgMJ40xk9amfNTNwEAAAAnQnA+mYiHtRt2m2OCwXj0SEpOXrX2ywK+He9/ckzpP0XZxh5OAAAAqB/BmSXPjV1qTgoG49Hj089jPXxy15kAAACAEyE4s6R2o+eTk5PNVcFgZDY+3XnUP9R609KyhxMAAADqR3BmiZd/x7/+PmcOCwbj4ZGSknL46K+Fw3rKPja5QnACAABA/QjOLHEpEPneql3mvGAwHh779v+o9esk+8zkFsEJAAAA9SM4s0SjM3bvO9ucFwxGurF1+wFrHklrQXACAABA/QjOrCpZYXBycoo5MhiMe/cSE5M2xezTFe4s+6hYB8EJAAAA9SM4syq/t2n/tz+ZU4PBuHdv2oz1sg+JNRGcAAAAUD+CM6s0OmOL9i8nJiaZa4ORh8f1G7d7D5znrjfKPiTWRHACAABA/QjObHDxjPz5l9Pm5mDkyZGScu/7H/4uU2WoRmfL2hQITgAAAKgfwZkNGp3htdmbzOXByJNj2YqdfiHd3e1QgwQnAAAA1I/gzJ6w0v3P/nfFHB8MG4xfTip0H/Lfpy70HTzPw8ck+0i4641uOoNGZ5DdnlsEJwAAANSP4MweN61h4rQ15gRhWHuIqKtWb+SlS9fNv1fGSExM+vTz2NBS/TKetCluqd987Kp1Xw18ZoGnbwfZvblCcAIAAED9CM5sE+Fx926CuUUYVh19B8139YqK7DAtOTnZfJOjxz+nLrSOnFTAt0OmtVmkWO//zqXu8U5JSRn23DtuWuvt5yQ4AQAAoH4EZ7ZpdMaBQxfYerrak7+e+eGnf8y/ycL45eTpAUPfvKPmEv71t3+lLZzf2/T8uGW3b8eb73DQuHjx+iszNwSW6P2ow2U1WsO4Ce+bl753b/ee70Qty5bJOYITAAAA6kdw5oToit17Tpg7wwYjPj6xVeTE0NL9Dhz86Yllm5SUfODgzyXKD3TVRu3b/4P5VhWOl6eu1qTtRXTTGsZPet9Re5Kv37i9ftOeIsV6PX4qWhGcy97/3Pwz95s/4xmeOUdwAgAAQP0IzhwqX33Y5cs3zKlh7bF+8x6RLu76aE+/jqZuM77/8W/zHRnGL7+e6dRjprZQJ2ne1IYtXhCxar5PVeNw7K9a/07pt7Bg6jrDzs155078kvd2lqkyJL/3k9NRtodzz77vXQpEypbJOYITAAAA6kdw5pBGZ+gzaF5KSoq5Nqw3jn/3p19w93RPZCxYpEsbw+TpszbGbN//xe7jX359YuuOAzPnbmlnnOwd0CX9AZ9uWsOsuVvMD6SekZyc0jpykmX3poW73li17sgvdx+3/lZ+eIgV+P3Ps3Pe2Fqp1oisn4cpVq9izWGWJJ731nYXTw6pBQAAAB5wzuDMOL+LjSx856OkJGtOb3P7dnyD5mMzvcyjCKF8BSKeyt9eEL9w02beNiJWf/vj7L17tm40q43k5OSZszc/5i0Tdw0f9c7581dFFpp/xkojJSXl5s07scd+7zf4DfFEro/YpI8hCvOLr46Jx7lzJ75ukzGye3OF4AQAAID6OVtwilQrUX5QzYajMu4us5EVq78w50uuh4iWiA5Tc1nL4seDS/Y9feai+UEVPz7ZefTxp0oK4m0tFNrz6RELT/56xvxjuRuJiUnfHvrlmZFvl6o42NOvU262eUCxXt37zK5e/znZ7blFcAIAAED9nC043bSGYc+98+/ZS4VCe8jushFtoU7L3/8898fWXrt2a/Dwt3JZmxLRb60iJp6/cM380Aoee/b9EFC8t2z9H0W8ubrCndtFT1m0+OOjcb/duHE76xs9OTnlwsVrh46cXL7y84FDF5SpPCS/t3jAqEx3JmeXWDGrvHEPITgBAACgfk4YnENHLhKBYej0iuwu28nvbXp32ScJCTm/UMqtW3c795wpVl72yDkmHqplxEQlXyVFFPpvv58NDu8rW/OscPWKylcgonDRXsYur855Y+uXXx//6edTZ/69dPHS9Utp/v3v8slfz+z/9qf3Vu0aNuqdOo1HFyzS+an87a155RKbIjgBAACgfk4ZnG+Lnnnz7Q/tmBbG/N7R3fq8fvHidammsjV++uVU9XrWPiAzlal249H//XfF/DQKG1/tOeEb3C3DOmePu94oePiYtP6dChbp4hPUzTeN+K22UKcCvh0si6X/QRUgOAEAAKB+ThecOsPAYW+lpNzb8833+TwiZPfalGjdMlWGrNvw9Y0bd8xR9aQhAnXW3C2+wd1tlEManaFmg1FHYn8zP58yRkpKyvL3P7fbMc9qRXACAABA/ZwtOEVi9eg7RyTN6TMXs3IpRatz8YyqVGv49g+/vX7j9qMmsE1MTLp0+cayFTuLFO1lxcNoH8U7sMuOjw6KJzU/vUPHteu3Ro5dkv5SLsgcwQkAAAD1c9rgvHXrblipfrJ77cNdbxStG1KqX7voKa/M3PjhJ4cOHz358y+njxz9dcu2/ROmrG7a+qUixVJnyrHKjDVZ4m3q0nvWqdMXzNnnoLHrq2OVao2w2wTC6kZwAgAAQP2cNjgTE5NE2zj2zD1RVq5eUS4FIsVqFPDtKP7r4hkpbnHIWrnpDCEl+y5a/PHFSzk50TSX48ef/3l6xEIvv9SNIFsxZI7gBAAAgPo5bXAmJ6fUajiKvJFx0xpCS/XbuHnvnTvxub6Sy5OHeBeuXr31wkvvedyfvAfZQHACAABA/ZwwOHv2Sw3O+PjE8tWH5SQ4vU31m43VFuokv91ZpG4Tb1OpioMnTF196pStDrIVqbln3/c9+s0pFNbDXUf2Zx/BCQAAAPVztuAUKtQYfvy7Pz/deVRXuIvsrifS6Iy1Go66czehW5/XZXc5HzetwSeoW8fur63d8PXPv5y+G5/bi3aKzr9+/fbBw7/MeWNbvaZjxVOI7Zn+GZENBCcAAADUzwmD011vFCnllqN5UN20UXPf3Cba6flxy2V3OS1vk9hWQvkawya/uvbI0V9v3roTH5+YlJQsAlIqyUyHuFM6V/bu3YQrV29++MmhPoPmB5bo4+LpmJNUnQ3BCQAAAPVzwuDMDQ8f0/c//i1qava8mLxWTeL1anRGsQX8Q3qUrvR0o5bjuved/fy4ZTPnbF72/s51G/d8uvPoBx8fWrP+qwVvfzhtxvpnRr4d1emVWg1HFy3dX18kdWey+HFS02oITgAAAKgfwfmQgGK9EhISRXC+v+YLV6+8fq1Id33q3LauXlGptFGp+421BvELl/u/5VqatkVwAgAAQP0IzoeUrTLk/uGi9z7ZefSpAhGyewH7ITgBAACgfgTnQ+o0Hi0F57eHfv4/D4LT+goGdOGw2ywhOAEAAKB+BOdDWrSfIAXnz7+c+r/87WX3Ijc8vE0x2/f/9fe5EuUH05xPRnACAABA/QjOh7SMmCgF59mzl0Ugye5Fjml0xtqNnk9KShbbdsyLyzn/88kITgAAAKgfwfmQpm1ekoLzxs07hcN6siMuPX2RLhOmrq5Ua3gONoubNmros4ukbfvSpFUaLcH5JAQnAAAA1I/gfEiths9LUZScnFyl9rMaHcFpJjbF3De3paSkHDpy8n/Z3/fr5hX10uSV0rbtNWCOovZwegd0LVF+YH6l7dAmOAEAAKB+BOdDSlUcLEWRGB27v8aRnxZFywxISkqStkxkx2nZ3cnppjUMHLZA/GxiYlLlWiOUU/Ie3qbYY7+JkB45domy/n2B4AQAAID6EZwPKRzWMz4+Qcqql6dw5OcDXXrNkjaLGBs275Xd+0Si5Rq1ejE5OeX8hate/h1l9zqKWKv2pinSmaXHTvxRwLeDbAFHIjgBAACgfgTnQzx8TEdjf5OyatzE95W1y8txxHaYMXuTtFnE+PnkaS//TrJlHs9dbyxStNfVazePxv2Wr0Ck7F5H0egMC97+QHpRv/1+1tNPKSWciuAEAACA+hGcDxFdFF5+4Cc7jy59b+f/vOX35lkiETdu2SeFmRgXLl4rHNZTtswTiWqNO/b7/IXblTMVk1ilNet3Sy/q+x/+KuBLcAIAAADWRHDKiRxy16f+V3Z7XubiGbn/25+kMBPj9u34nM1VG1SiT8EiXWQ3OlBqcG4wB+eHnxyS3etgBCcAAADUj+BUH/ufauimNfz2x79SmImRnJxi6jrDTf0zKml0hrlvbpVe1ISpq5U1RxTBCQAAAPUjONVEozP2Hjhvw5a94heyu2yqYJEu585dkcJMGtNnbXD1ipItpjqimfsOni9eTkpKSqOW4+y8VZ+A4AQAAID6EZxq4uXf6fsf/z595qLejgemuutTD4W9du2WlJrS2PHht25OMYVvpZrD795NuHDxmndAV9ldDkZwAgAAQP0ITjUpWqZ/UlLy7dvxRYr2kt1lO+56Y4nyA2/fiTe35v3x48//eCpqip2cEg3/8y+nP/nsiOJ22BKcAAAAUD+CU00aNH9B6r1y1Z6R3WU77vrojMF59dpN78BusiVVqnSVIcHhfWU3Oh7BCQAAAPUjOFXDvWB0h24zpN5r0nr8/wra6YRDEZyBxXtfvXpTemppiP4MKtFHtqRKKXRGYoITAAAA6kdwqoZGZxjy7CKp97r1eV12r015+HQ4deqC9NTSSEpKDq8wSLYYrIngBAAAgPoRnKohgnPE6MVS7z0/bpnsXpvK5xm5b/+P0lNL487dhJDwfrLFYE0EJwAAANSP4FQNN61h9IvLpN6b++Y2dzsGiXjqeQu2S08tjX/PXrLnTLl5EcEJAAAA9SM4VUOjMzwz8m2p99Zt+trOVyWp02TMnXTzBqWugM4ZLouiXAQnAAAA1I/gVA13fXTnnjOl3tu5Ky6fZ6RsAZvS6I29+s+9ezdBPPu1a7fKVXvG3V6zFuVRBCcAAADUj+BUk8Ytx0nBeST2t3wF7BqcgrveWLry062jJpWqNJgcsjm2MAAAANSP4FSTEuUHxscniuA8Gvubi2eU7F7IuN/fLSy7UTUITgAAAKgfwaky0V2nr17/VbO2L6k4pezCTWsoVnZgmSpDNDp1HvrL+wsAAAD1IzhVRqMzuHpGqTWi7MVdbxz0zFs3b925ezehddQk2b3qQHACAABA/QhOOCGR5UfjfpPOd501d7OrfWf0tQ6CEwAAAOpHcMIJBZfse+36LSk4V6z6wtbnu7rrReJae58zwQkAAAD1IzjxOGo8U9Rdb6xca0RCYpIUnG8v+djFy7bBWbLi4LaGyRrrXpiU4AQAAID6EZzIXH7v6EWLPxrz4nLVnS8qgrNq3WcT04Jz+qyNbrY8pFZ05tMjFg4e9paVn4XgBAAAgPoRnMicf0iPCxevXb5yI6x0f9ldCieCs1LN4QkJqdePEWPoyLfFLbJlrEgE+b4DPz49YhHBCQAAAMgQnMhcSIk+V6+lngY5adoamwab1bmLlS/V7/r121JwtoqcKFvAuirWGB6fkPjCyyvcrHvgLsEJAAAA9SM4kbkS5QfduHFHBNuJ7/8q4NNBdq/C5fc2nTp9Qax8UlJy8XIDZfda18gxS8QTzX1zG3s4AQAAABmCE5kLLt5b2sN55crNkJL9ZPcqnKuX4dtDP4uV//7Hvz39OsrutSI3nWHdpj3iibbuOGDl/cAEJwAAANSP4ETmCoX2uHjpukip5OTkqE6vqOuoWlevqLUbvhYrP2veFpvOGJSvQOTBw7+klu0Pf3tYdz8wwQkAAAD1IziROS//Tn/+9Z9IKTFem7PZptlmC+MnrUxISGrU8kXZ7dbl4hn1+59nxSa6fv22X0h32b25QnACAABA/QhOZM5dH71w8UdScG6O2ae6i6O0M04+f+FqodAestutS3T4f/9dEZsoJeVesbJWPVmU4AQAAID6EZzInAjO4PC+P/70T2JS0rOjF6suOAOL91n07kf5vU2y261LBOe581elLG/Q/AXZvblCcAIAAED9CE48TsGArpVqjpDdqBau1r1OSWbEU/zxp/nA476D52t01jvwmOAEAACA+hGceAJ1TRdkZ08ViDwS+6sUnLPnx7h4Wi9xCU4AAACoH8EJ5JxGa1i7YbcUnF98ddyV4AQAAADSITiBXOk9cJ4UnOfOX/UO7Cq7N+cITgAAAKgfwQnkim9w9z//OieCMykpuUpt653vSnACAABA/QhOIFc0OmOT1uN3fXX8naWfaAt1kt2bcwQnAAAA1I/gBHLLXR+dr0Ckq9aQP8NdOUdwAgAAQP0ITkCRCE4AAACoH8EJKBLBCQAAAPUjOJFtHt5Gn4Aorb9BdjusieAEAACA+hGceZ273lQoOLJlk6aVKreW3ZWRuz66bu3m2xeV+GZdyJfvh40fVs3T1yhbxlpcvaI0ujzctAQnAAAA1I/gzNNEQJav2PqjxcWPbQ08uiVozOAaXn7GxyhYOGrrovDYLUFi4fsCI1o30uhMsofNPVGbixZ/3K3P67Lb8xCCEwAAAOpHcOZpnr7GmIUl4mLMARkbE7RvbejeNY8Ssn9dSFpqmpdfPqOs1YPTXW8MKNb7xs07R2J/FUksuzevIDgBAACgfgRnnqYvZNj1XtF0eyyzRwTn/AkV3LRWDk6NztCp+2sp9+6dOn3B07ej7N68guAEAACA+hGcjuTwcxTze0e/+Ey1uJigHDRnbEzgtxtC6tZpYfWdkGKzzHh90717927dului/CB3va1OE1U0ghMAAADqR3A6TAHfjsbOr2oLdZLdbmcuXqYJw6vuXRN6YH1ItmxbVLxe3RayR7MKUZjrN+0RwSlGW+OUPDp1EMEJAAAA9SM4HcNNa5gyfX1ycnKFGsNkd9ld6v5D7yJRvoFRvgEPiFvS8xELpLtX8PIzamwWRZ/sPCoF5/iJK8W2kt1rCyJry1Ub6h/aQ3a7wxCcAAAAUD+C0zH8grufv3BVBFXVuiNldymB1t/QtkXj9i3NIlo1Ci/T1j3DYjbirjeu2bBbCs43F+1w87J5cGp0xjaGybdu3d287Zt8BSJl9zoGwQkAAAD1Izgdo3r9kVJQtWg/QdrHaGcanfyW9IqERHy7MfjY1kDJd9sD+nSqZ4vLn2RKozUOH/2utH3mvLnVTRslW8AW9n/7k3i6H38+9X8eEbK7HIPgBAAAgPoRnI7RuedMKaj6DJovu8vW3PXR5Sq0njC8WtWqrTKd78fFy9S+VaMjmx/MDySas2/nunYLTrFW3oHd/vzrXHx8YvN2EzQ6mwe5vkiXf89eFm/HzydPs4cTAAAAsBaC0zGee2GpFJyvzNxo50lxPP2MMQvD47YGfvBu8fzeqbd4+RkDwyKkI2aLhrcbN7Ta4U3BltqUxLwVHhBqv11/7npjeIVBTVqPd7fL7t+CAV2kI5wPHz35f+7tZPc6BsEJNfvx51PSH3G2Htdv3O739BuyZ88Ku61h+iGeVLYaWSFeoHiZ5oew43hv1S7ZmthBVMdXzp2/Yl6DtJGcnLJ4+aeyJe0ju5+T9B9Ix37GWkdNOvPvJfOtWRt2+3x+ufuE7EEAODeC0wE0esOkaWukP3a37jjwlB13qWl00QULR329KlQ05NerQ7V+RletafKzVWJjgob1rjV7fMWj6XZspicW2PFOCV1hg9UvgqIE2kKd/vjzP/F2fPLZ0ac4pBbINbt91SY4bTccEpwiLEVemtcg3fjl1zMVqjtgjr3sfk4IzqwMghPIawhOB9DojROmrpb+2P31t3//d383Y9a5aQ2efh3dtNnY9eemM/kHRbZu3uSFp6svmlLu0MbUHZhScObz7LB5Qbj4bdxWIdBSmBnFbgn64N3izRs3dXvs+Z9q5K437t7znXg7Zs+Psc+kuE9GcELN7PZVm+C03bB/cIqkFGFpfvqHx81bd58bu0S2vB1k93OinOBs1val02cumm/N2sjZ57P3wHlXr90yP0TWBsEJ5DUEp2MMfGaB9Mfurdt3Q0r2zfpuQ7+g7gvf/eivv8/t3BUXVrq/7N6MxCMHFW0/tHftXe+FHd8WGBfzICllwZlFhzcHvz6uYu1aLbyLGDT61MeXPaMaicicNXeLeDs695wlu8thCE6o2bYdB1JSMtlPZfVBcNpu2D84RVKKsDQ/fYbx8WdHZMvbwfKVn4u/ps1r8KSRmJi0/9ufLHtiHf4Z+2xXbNb/N0xKSt7x4UHLz2adeL1HY3/L+hOJrbRg0QeyBwHg3AhOx6hYc7j0J6/4M7p05afd9VnaXenhY/r0c/MFKsUQ5enq9bgZXEUQNm/S9MC6kNgYeTcKOQtOiWhX8eOvPl+5arXMZx5SF43O0N40VXyrCCvVT3aXwxCcULkqtUc8M/LtlWu+PHTk5LXrtuolgtN2w/7BKZLS/NyZjXPnr0R1fEX2I/bROmrShKmrP/r0cMZPckJC0uGjJxe8/aGx86uyn1LCZ6xe07Ez52w+cPDnK1duZGxC0X6//X5289Zvnh6+sHi5gel/MLvE/+8vT1m1/YNvf/n1jGhX8xOkDfHUZ/699MHHh0a9sDSXTwRAjQhOhxk+6h3x5+/Xe7/TFuoku+tRGrZ40fyH9/3x9z/nCxbpKlvGIr93dP+udQ6sD47NkIuS3ASnJC4m8MjmoC1vhffqWK+AjwMu7mJFAcV7bd72jR1mxM0qghNOJOM37xyHoqgg80PcH1YJzsuXb3TrM1u2gIzseaXxxCQTDyse3Ly0lYIz7tjvsgUyytkGf3vJx+nPn7RzcGY6XVD64cCpgyyytWEV9RnrPXCeaE7zQmlD3CJuly2ZS7Pnx4gINz9B2hBZ65BTcAEoBMH5EHd96s4u+1SHu95YMKBLAd8OstsfxVVrmJh25qc0EhOTwisMli0m0eij27RofGzb487JzH1wWsTFBM19qWKR0Ehpqls1yl/QVK7a0CzuarYHghNOJGf9k6mlK3am31FjleA88++l1lGTZAvI5CwGZBO3PCoGHk8WnFk5/y1nG3z6rI3x8YnmH7B7cGacLujGzTuyW44d/8MvuLvsB+0pWxtWaZ+xfft/NC+UNsT/Shs275Utlhvi3RHvkfnR04bVnwWA6hCcD4jYCC7Zd9yEFW2NU2R3KUE+j4iY7fvNf36njRoNRskWkwQXi9izOnUq2sewYnAKsTFBK2eXdrPXtTptQGF7aAlOOJGc9U+mZFFkleDMyu6XnMWA+P7988nT5qWtFJybYvbJFsgoZxt88LC3ROOZf8C+wSk21A8//WN+4vtDVMrHnx2RHcIqVu/Z0YtlP2tP2dqwSvuMTZi6+s7dBPNyaePvf843bDFOtmSOiXcn/UdIGrbYjwpAXQjOBwJL9Pn9/rUxxN9zs+ZsUcpspWnctFFH436T/vi2jBr1MwlOjc40YUTVx085K1g3OAXRnFOeqyJd2xO5RXDCieSsfzIlm1fGKsH53Q9/ye7NKGcxIMQd+928tDWCU/z1tHTFTtkCGeVsg8sOzrRncGYMFfEuj33pPdFp5t+nDYdMHWSRrQ2rtM+YKN6MkwDHxydOn7VRtmSObdi8V3xEzQ+dNvbt/1G2GIC8huA0c9dHN23zkvlPx3v3vjnwk1Kux5imgG8H6VqR6Ue1uiNliwnuetMnS4vJajAjqwencGhjcLnyrWXrg5wgOOFEctY/mUpfX2Lk+HHSr9LnXx6T3ZtRjmPgg48PmZe2RnDevZswdcY62QIZ5WyD12s69q+/z5l/wL7BmXG6IGmXYMaAceDUQUK2NqwCP2MrVn9huyBs2GLc3/+cNz9o2rhzN2HC1NWyJQHkNQTnA6WrDLFMrfbnX/89VUBZwakt1PnM2Ycu4iz+2ihRfpBsMVHO4aXbHtokT8GMbBGcsTFBU0dV0aj4wFrFIDjhRHLWP5kSEXLs+B+WL825D874+MTX58XI7s0oxzHwymsbLMcxPj4GHiV9cP579lJWcivHG1x0kWXb2i04M50uSESUuGvgMwtkR9UmJibNf2t7+h+3p2xtWAV+xmw6dVCm0wX98uuZJx5LDMDpEZwPFA7reenydemPSPGLggFdFHXBDxGc4quGtHrSuHr1ZkCxXrLFROwZ2zXM9DooMrYITmHP6tAiocpqdVUiOOFEctw/ypHjGHAIdW1w2ey4YljO1cx0EhoHTh1k0w1rn8+Y7aYOOnDwZ/Mjpg1rPTIAtSM4H8jvbfr1t3+lPyXj4xNCS/VT0Jyl0h7OdDPRifHHn/9p/eWXVHHTmYb2rvXEEzgFGwXn8e0BzRo3la0Vso3ghBMhOO1MRRs806RMv1ss434zB04d5ATBmenUQbm/bIndLrsCQI0IzgfyeUbu/eYH6U/J5OTkyrVHKCo4C/h0+O2Ph6ZP2L3nu4wzG4ngfK5/zWOOC07Rus/0rsVRtblFcMKJEJx2pqINnnG6INn1NmWX/ZCGo6YOcoLgFGGZceqg3J9pyXRBAB6D4HzAxTNS/Ikp/Skp/tys13SMfS7ImUViZY6deOifgRcv+9TVK0q22OODMy4mcM/q0MObgsWvcxyc4kEevwf11TGVXLUEZ+4QnHAiBKedqWiDZ5wuKOO0QBmXse7FPLLOCYJTyHjJUzFyE4ey6aakwXRBACwIzgdcPKPmLdgu/UEpgrNuE2UFZz6P9ru+Oi6tnjRGj1uW3T2cy2aUKVe+ze5VqZfotATnpjdTgzM2JpVlyUc5tDF40dRyrzxf+cCGENldFmIB8bCyFUP2EJxwIgSnnallg2e69zJj+WTcC5qQkDR7/pOn4bE65whOqx/+mulhukwXBMCC4HxAozOMn/i+9AelCM6aDZ5XVnAWiFiz7itp9cRITk5uZ5zyv4LyNXxMcIqw9PCJ9guK/HpVmPitFJwaffSQnrW/XhXas0O9aaMqf7Mu5MS2zGNV5OihTUHtWzUWz6LRRT83oMaj9nO+91qZpwjOXCI44UQITjtTywbPeH5mprvFMj0K1CFTBzlHcAqZTh20YvUXssWyyLqPBsD5EJwP6T1wvvRnZXxCYljp/oo6h9PVK2rG65uk1RMjPj6xUq0RsmWERwRnoLild6d67vrogoWjdi4vKm78YkWYp5/5BeoKGURDavSmQsGRUW0aLptR5tCm4GPbAlOPno1J/dndq8ImDK9aLLydCFTpR8qWb/Oo4Hx/JsGZawQnnAjBaWeq2OBPnC4ovYxHgTpk6iCnCU4r7pPs1mf25ctMFwTgcQjOh7Q1TJb+rLx69aZvcHdFBadGbxw8/C1p9cS4detuUPHesmWER+3hFLc0adhMLCCKsUP7BlsXhffqWC/TqX3c7y9TvkKbQT3qTH2uyqSRVTtENCgSGuH28GmZWj/Dp0uLxaUdi5ve+zNLE5y5RXDCiRCcdqaKDZ7xQNnH7BbLWDViYftfcsNpgtOKUwdZ/YxQAM6H4HxI7UbPS39W/v3PeRfPSNm9Dtes7cvS6om/ak+duuCV4ZoowhODU+LhbRRhafltRuJed/39/97/hexeQdz48vBqG98ouSGDSSOqungxaVDuEJxwIgSnnalig3/w8SHzyqWNx+8Wy3jcpv2nDnKa4BSsEopWDFcATozgfEjpSk9Lf1weOnLy//K3l93rcGGl+99NOwbmvZWfZ7oDNovBaRX5vUW4ZkLcLlsS2UZwwokQnHam/A0uQlHkonnl0sbjayfjUaD2nzrImYIz06mDzp+/auo6XbbkY1jx0FwATozgfEhweJ+kpGTxx+X6TXszXnHE4UTI7fjooFi9hITEuk3GODw4YUMEJ5wIwWlnyt/gGacLio9PnD5ro2yx9DJt1Lhjv8sWsylnCk4h405j2UVQnyjjFWuy+wgA8gKC8yH6Ip1v3Lgt/sR8ftxS2V0KEV5x8OUrN8Qf8W7azHtY/cFpdH3ES8tbCE44kYxf03M8HNV4BKcVZTpdUFaOj92weW9KykNHgdp5chonC85c7p+M6vjKufNXzD+WNpguCEBGBOdDCvh0+PGnf+7GJ1St+6zsLoVw1xvLV3+mUGhP2e0Wag9On6Bu23Yc8AnqmumJo3kIwQknQnDamcKDM9PpgrIyA9DAZxZcu576j8KWYeepg5wsOHN5BibTBQHIIoLzISLnylYd2jJigqKuwJktag9OQ6dXxd9Y3frMdtMaZHflLQQnnAjBaWcKD86MOypFRoqYlC2WUY53jVqLkwWnkGk0frn7hGyxjMR78cNP/5h/IG0wXRCATBGccqlTsyrpaijZpergFBtfutbo+k17VP0uWAHBCSdCcNqZkoMz01MxRUaKgJEtman5b21PTMzeyZ9W5HzBmelVNM+dvxLV8RXZkjIZd1OLwXRBADJFcDobVQenq1fUxi37xF9aJ3874+nXUXZv3kJwwokQnHam5ODMOF1QtiabzfS8Qbsdxul8wSnkbOogpgsCkHUEp7NRdXA+5RGxe+934u+tmzfv+Idk6V+7nRbBCSei5P7JIoLTKjI9JvbMv5daR02SLfkYGVPHbhPVOGVw5mDqIPF+iXfNvGjauHz5Rrc+s2VLAoBAcDobVQfn/3lExB77Xfy9lZKSElqqn+zevIXghBMhOO1MsRs802s/ioCULfZ44yetvH0n3vzD94fdpg5yyuDMdOqgm7fuPjd2iWxJi4y7qcVguiAAj0JwOht1B2f+9r+cPC391VWu6lDZvargro/28OlghRNQCU44EYLTzhS7wTNOF3Tj5p1nRy+WLfZ4mQbSb7+ftcPZg04ZnEKmUwc96h8CMt1NzXRBAB6D4HQ2aj+k9tSZi9LfXvWajZXdqwo+Qd2Onfgjuut02e3ZRnDCiRCcdqbMDZ7pdEHWGvYJHmcNzmxNHcR0QQCyi+B0NqoOTg8f0/kLV6W/vdpk55QehdDoDL0HzhMr/87ST2R3ZRvBCSdCcNqZMjd4psdhWnHY4ZBOZw1OIetTB2XcTc10QQAej+B0NuoNTne90S+4+9Vrt6S/wLr2fl22gPKJl7Bi9Rdi5Xd9eSx/QZPs3uwhOOFECE47U+YGP3DwZ/Pa2GbYYeogJw7OTKcO+uGnf2SXq8l0N/X581dNuT+uB4DzIjidjaqDM6BY75tpB+qMeP5djc4gW0bhPHw6SGe2fPfDXwQnYEFw2pkCN3im0wVZd9hhP5sTB2emZ8ZmPMOW6YIA5ADB6WxUHZyhpfrdSZt7cMKU1W7aKNkyCqcv0uXfs5fFyv9z6oK2UGfZvdlDcMKJEJx2psANnvE4TFsMW59J6MTBKWRl6qCMR94yXRCAJyI4nY2qgzOkVD/LZPez5m5x8YyULaNwvsHdr11PPST46rVbgcV7y+7NHoITToTgtDOlbfBMj8MUt4jbZUtmS8YLcto6fpw7OJ84dVCmu6mZLgjAExGczsZpgnPJ8s9UF5yFQntKhwQnJCTVbTJGo8vFxVEITjgRgtPOlLbBp8/aGB+faF6VtPHBx4dki2VXpqcd2vTwTucOTiHTqYPeXvKxdC/TBQHIGYLT2ThNcK7d8HU+1QanGENGLHTT5uIcVIITToTgtDOlbfCMGZODy29mlOlph4+6mIdVOH1wZtrwx47/4RfcXWzt334/a74pbdh0awNwGgSns3Gaczi37TigwuDsIb5FSev/3spdBCcgITjtTFEbPNPjMDNOf5ozK1Z/Yc99bk4fnJk2vDT973Njl9y8ddd8U9pguiAAWUFwOhtVB2eRor1u3DAHW2pwFlBZcPoEdbt89aa0/ie+/7OATwfZAtlAcMKJWPFresMW40SrWBrDbh1FcOaYTY/DtPNZhU4fnELGqYOko2oztj3TBQHIIoLT2ag3OAVtoc6XLl2X/iZTY3DqCnf+59QFaf1v3b7rH9JDtkA2EJxwIlb8mi5+Svys+VEIzkdQTnDWazr2r7/PmVcibVj3so0ZL+9puxDKC8Ep3hrxBpmfPm2IjRx37Hfzb9IG0wUByCKC09moOjif8oiwzGQYs90Bwemuj/b06yi7Mevye5u+PfTgq0+5qkNlC2QDwQknYsWv6eMnrbSc6S0GwZkp5QSnHeb1yfTKkLKLeVhLXghOIeM5txcvXrP8c7A0mC4IQNYRnM5G1cH5fx4Rln9DXb5yl/1nqa1ca8SpMxdGjl3i6pWTS4C6642Llnwsrb8YrSInyhbIBoITTsSKX9Nl851m+jgNW4z7YvdxqXNu3b67ccve4uUGypbJLtvFwNPDF5787UxSUnJKSsp/5668NHmVbIEcsFEXic0oNqZ0prp4F8RGfuJ1TTKmi9V3P2Z6zRUbTWaTR4Iz038mkA2mCwKQdQSns1F1cIrM27z1G+kvs+mvb8pZ9eWYeLp5C7aLp97zzQ85u6KJ+KmO3V+T1l+MQc8sEAkqWyarCE44ESt+TV+6Ymf6E8kyPk6V2iNOfP+X+e77Qywv0iiXU9TYKAaGj3r3atqJ39IQX/RnztksWyy7bNFFYgOKzSg7i09sarHBZUtaZHqC5V9/n6vXdKxsyVzKeEFOG+1/yyPBmenUQbLx5e4Tsp8CgEchOJ2NqoNTGDxsofSXWfe+s92tFF1e/p0atXzR60nHyrp4Rn3w0SHx1GfOXNQW6iS7NytEXgYU6y2+f0gv4enhC3P+EghOOBErfk2XfSnP+DgZpzwRI/d71WwRAyLhjh3/w/xY6cbf/5x/4p7Dx7NFF2W61+vxXZdxuiDxW3GjbLHce3b0YssM4ZZhizMM80hwCpn+f2QZVt9NDcC5EZzORu3B6enX8cDBn2/fjg8r3V92V864aQ0vTnxffOep02SM7C4ZV6+oA/fPwIyPTwyvMEh2bxa5ekW+ueiDq9duilfhH8qkQci7ipcb2LP/3AVvf/jF7uPXrj+Y5se6I+PX/YxTyEgjB1/c6zUd+/aSj49/9+et2/KrQUhD5NPlyzfEM86cszkHe+0ynZ1FjJw1TO+B8zZv/UbEamKi/IRGaYjbT5+5+MHHh0a9sDQHxxhvitlnfqCHR8Y9XeLBx09aefDwLxm3m9hiZ/69JNZTrK3sp3JGbHaRRj/9cirjq05KSj752xlxby53qFapPWL0+OUx2/f/fPJ0+sO5pSG9IvEhF5+B1lGTZD/7RLb+jOXYoz6c0mC6IADZQnA6G7UHp7ve6B3YNSi8j+z2HCtaZoB06bAn7jEQwflT2r9eN2v7kuzerMvvbfIN7lbAt0Ou9tASnFCzbTsOiC/K0v9NNh22C85XXtvwxNPY0g+RIq/Pi5E9yONZMTg///JYtjb4v2cvZfcEvCwGp0jNjFdrzHSIyspltOz48GBWXrVYRiwp+9ksyu4n+dff/s16FtrhM5YbGc+/lQbTBQHILoLT2ag9OK2uc8+Z0t+RLdtPkN0lI4Lz519OSwsPGbFIdq+9EZxQs4xHHtpoZGyzjFcLFEN8U58+a2P6xZ4o0+MbHz+y27R+wd1/+Okf8w+nG2f+vZTdfWXZ3eA5aFrZdE3SEJtabPD0i2V9u+XgZcpk/VWLJWU/m0U23bB2+IzlxqOmDmK6IADZRXA6G4IzPY3O8OrMjdLfkcYuT7jsW/rgfH3elpzNG2Q1BCfUzIHBKRrm1Gnz5XAtIwc70+wTAxn3cSUlJcsSLivsEJxiA4rNaP75tCE2tSwaCU6nCU7xjmc6dZCNLjkDwIkRnM6G4EzPxTNy3cavpb8j+z/9puxeGRGcR+N+kxZeve4r8VvZAnZFcELNHBicQsuICV/sPi7NIiP+K74fP2Ym1UexWwyMemHpDz/9k5iYlHL/sijzFmyTLZAVdghOQWzGLdu+uXLlhlhV0ckHD/8iNrVsGYLTaYJTyDh1kHjfmS4IQHYRnM6G4ExPBOfeb36Q/pocN2HF4y9S4uIZ9enOo9LCn3x2JF8Be18F9CEEJwAAANSP4HQ2BGd6rl5RliOC3ly0w037uJ2Wok7fXfqJtPBXX594yiNCtoBdEZwAAABQP4LT2RCc6emLdD773xWpIbds2//4nZbueuNzY5dKC+/cFZuvAMEJAAAA5ArB6WwIzvSCSvS5eu2W1JDfHvrlKY/2sgVkmrd7WVp45dovOYcTAAAAyCWC09kQnBbu+ugS5QbevhMvNeTpMxcL+HaQLSMjAlWaIGHs+OWyu+yN4AQAAID6EZzOhuC0EMFZXATnbXNwxscnlq0y9PHzBgnPjHx7x0cHQ0r2k91ubwQnAAAA1I/gdDYEp4UIzoDiva9evSkFpxg9+s7W6AyyxdIxif+6aQ0OPphWQnACAABA/QhOZ0Nwpqcr1Ons2cvm3Lx3b96C7U/cw6kUBCcAAADUj+B0NgRnei6eUQePnDTn5r17MTsOyBZQLoITAAAA6kdwOhuCMz1Xr6i33vnQnJv37n32eaxsAeUiOAEAAKB+BKezIThlajcebc7Ne/dmzt7MIbUAAACA3RCczobgzMBo7DJ915dxm2L2BRTv7a6WkCM4AQAAoH4EpyPZIn7sE5yq2U94n1jbfAUiXApEpr9R6QhOAAAAqB/B6TDFyg6YOmNdfu/US3FYkR2CM6B47xr1n9Po1NSc6kNwAgAAQP0ITsdw0xqWrfj83r17zdq+JLsrl+wQnB99evjCxWvB4X1lt8OaCE4AAACoH8HpGPoiXf49e0kE54Qpq617eKqtg7NomQHx8YlizQ2dX5XdBWsiOAEAAKB+BKdjlK48JCUlRWTbqrVf5bPquYW2Ds5GLceJ1Rbjpcmr1HUmp8oQnAAAAFA/gtMxLNm2b/+P+QpEyO7NDVsHZ/e+s6U1X7Fql4uXqqbhUReCEwAAAOpHcDqGqdsMKdv++vuce4Z7c8PWwTlyzBJpzb/Yfdy6+2bxEIITAAAA6kdwOkbvgfOkbLt+/XbqxSEzLJBjNg1Ojc7w8pTV0pr/+PM/T3kQnDZDcAIAAED9CE7H6DXAHJzJySllqgyx4smQNg1ON61h+qyN0pr/e/aSl18n2QKwGoITAAAA6kdwOoah0ytStonRsPkLaglOsZ5jX3pPWu3LV274h/Rwp4tshA0LAAAA9SM4HaNqnWelbBOjSp1n1RKcQudes6TVvnT5hl9Id4LTVtiwAAAAUD+C0zE8/TruO/CjyLbzF676BnWT3Zsbtg7OUpUG37p1R6z5LyfPaHRcFsVmCE4AAACoH8HpGO56Y8mKgz//4ti4CSvctFGye3PD1sHppjUMHr7wz7/+mzRtjfi17F5YDcEJAAAA9SM4HSm/t0l2S+7ZOjglusKdbbHyeIDgBAAAgPoRnM7GPsEJmyM4AQAAoH4Ep7MhOJ0EwQkAAAD1IzidDcHpJAhOAAAAqB/B6WwITidBcAIAAED9CE5nQ3A6CYITAAAA6kdwOhuC00kQnAAAAFA/gtPZEJxOguAEAACA+hGcZp6+HYqWGaAr3Fl2u+oQnE6C4AQAAID6EZypCvh2+OiTw9ev3z4a+5t/aA/ZvepCcDoJghMAAADqR3Cmqlrn2XtpY/X6r/J7m2QLqIiqg9NVa+gzcF5g8T6y2/MighMAAADqR3Cm6tTjNXNu3rt35epNn6BusgVURNXB+X/523//498ffnJIozPI7spzCE4AAACoH8GZauAzC8y5ee/e7TvxYaX7yxZQEVUH51MeEV/v/f7a9VviLXDXG2X35i0EJwAAANSP4Ew1bNQ75ty8d+/OnfgS5QfKFlARVQeni2fkR58cFu/Ca7M35/WdnAQnAAAA1I/gTDXsuYeCs1jZAbIFVETtwfnBx4fEu/Dvf5d1hTvJ7s1bCE4AAACoH8GZqu/g+VJtinHz1p1CYT1lC6iIqoMzX4HIz7+IE+9CcnJKSKl+snvzFoITAAAA6kdwpuo1YJ5Um2KcPnNJX6SLbAEVUXtw7vrqmHgXkpOTQ0sSnAAAAIC6EZypeg2YK9WmGHv2fZ/fW76Aiqg6ON10hreXfBwfn/jhx4c8fDrI7s1bCE4AAACoH8GZqt/Tb5hz8969qdPXqXp+VFUHp+Ab3L1y7RFa/46y2/McghMAAADqR3CmenbMYqk2k5KS6zUbS3DC8QhOAAAAqB/BGa3RGaa9tl4Kzv/OXS7gq6AjOTXZT1+CM+vc9dHuOqX+4wLBCQAAAPUjOKNdvaLeWfKJFJx7v/nh//K3ly3gKIXDei57f2d2p8wlOLOuev3nYo/97hfSXXa7IhCcAAAAUD+CM/Xajzs+/FYKzjlvbHXTGmQLOIS73vjc2CUpKffeXPSBJjt74QjOLBJbdcizi+7eTaha51nZXYpAcAIAAED9CM5oUZhH436TgrN11CTZvY6SzzPi673fiVVKSkouVelp2b2PQXBmkYtX1Mw5m5OTUzr3mpmtpLcTghMAAADqR3BG+wR2O3f+qki7H3/6RzlX4BRr9d+5K/cr+N7TIxa5Zzk/CM4scvGMemPhDrF5X3h5hatXlOxexyM4AQAAoH55PTjdC0aXrTo0ISExOTl54DMLlLOnyze4u5TBYsx4fVPWV8wpg1P0tm9QN13hzlacQNhNZxj94nKxeV+c+D7BCQAAANiCEoPzflyZ0n4hv9fqQkr2u3jx+jcHfvLy6/i/gkoJThfPqBWrdyWnpCQnp3TpNUt272M4ZXBWqDHs+o3bv5w8HViit+yu3Ags3nvXl8er1R2pxAvhEJwAAABQP8UFp5d/pyXLPz11+uJff59bueZL3+DumcaAuLFU5aeLlRuY+zl+3PXRwSX6KOdgWgtd4c7V642sXHO4h082rtSinOAUb03Gy7podEbR0m66bLxruiKdj8T+Ku3sfW32ZivGoXSgsnuG2xWB4AQAAID6KS44Bw5dIKWFNH78+VR4+UGyZTRaQ99B8+/eTbh16+7r82K8/DvKFnBGqbt8s0IJwSmasGjp/qNfXN6558z0fejhY+red/bHnx4ZM/49T78sVbRowm59Xjd/Gu7dm/Lq2qyfzqpuBCcAAADUT3HBOXpc6ml16cfX+75zf/hIV5cCkR98fMh89717b73zYbb2mDk3JQRn4aI9L12+Id6apKTk+s1fkA6NdtUaFr77kfSWidF74Pz0P/IoLp6RW7Z+I/3InTvx2ZqwV90ITgAAAKif4oKzaNn+59Mmy7GMuW9uS38+p/h1ZMdpCQlJ0r3JycnRXadb8UhLVVNCcHbqPlN6a8QYOWaJRmvQ6AyDh791926C+dZ79yZOW/OYfZXi3ZQm8snnEXni+7+kH5F9DOxMrG2ryInFyg6Q3W4rBCcAAADUT3HB6ao1DHxmQXJyitQY0rh0+XrRMv3T94mHT4dF736UkJAoLXDw8C/5vbN60KlzU0Jwpj8u+ukRi9y0hsq1RiQmmv+B4N69lNu34+s2GSP7KYsCvh1MXWe8NHlV2apDxRt97v7lYb77/q+AYr2zfmixdYnPXrlqQxMSksZPfD/3pw1nCcEJAAAA9VNccN5nfG32JilNLGPz1m9k+zBdvCInTVtjvvvePWOXV9nJKSghOHv0m2N+V+7daxUx8f/yt1+zfrf59/fHK69tcPXKPNvEm9gqcmJSUrJY7NjxP7SFOl29evOfUxe8A7rKlrQnF8+omG37xSq9t3KX+LXsXpsgOAEAAKB+ygzO1INmR41beufOgyMwRYFUqjlctlj+gtEtIybEHvtdLLB+056MOzlFvWh0Bgceh2l/SgjOyrVGSO/a7TvxwSX7VqnzrPiFdIt4H99e/LG2cCfZj1i4eEbOeWOrtPDNW3dKlB804vl3i5cb6MB/TRCfn7Hjl0t73Zeu2ElwAgAAAFmk0OAU3LSG1lETfz55OiXFfHjts2MWZzyaUXSIh7cpusv06K7T098o4jOsdP+mbV7q3me2scur2kKdLfc6NyUEp4dPh91ffyfesrP/Xfb07Tj/rR3SO3jp8o2J09ZIJ2c+irj3pUkrpeXFGDJikUuBSHG7o4LTXR/tG9zt37OXpPV5/sVlHFILAAAAZJFyg1MQ3/WFV17bEB+fuqtzxeov8nlEyJbJIHWXZnB43+0ffhsfn5icnCx69caN26UrPe3AXWT2pITgFO9aeMXBV6/d+v2Ps64eEfv2/yjevsNHT5asODgre5trNXxeOqRWjB0fHRQ/UsC3Q3j5QRmv6mkHbl6GUWOXSisjRuXaz8oWsBWCEwAAAOqn6OCUiN4oWmZApx4zazcenZVceXr4wkuXrpv74P4xnFOmr/PwsflkMxrdQ78tWDiqXcvGjRs00/ob3bT2m+pGCcEpuBeM7jVg7qy5W1w9Ixs0f6F2o+fdC3b0D4po1ayJ4OX/0E5C14e3j6dfxw8+Ml/25tz5q17+nZau2JmQkDhg6Jt2+FcDjc5QsEgXL/+O0nOJ37aMmHDnTrwwYerq+7fYpXsJTgAAAKifCoJTIu3tlN0oI0qg76D5UqhYxvy3ttvhpLvw0m2H9an1v7TrhRbwMS57rex32wNPbA/88N3iPTvUCy7WXtwuMkxawCpEEYk2y/9wSyskOAWRaq5eUeJd8/AR26fd8L41v1wRJjbIiR2Bg3vW0ujMqx1UNGLCiKpi+1jeX/ELbaHOR47+Kr2DFao/8+tvZ8QvFi//9PGH4+Zefm9T38HzT52+cPy7P8tVHZrWnMZqdUdWqjnMu0gXEc8Rpqn+oT3S/5RNEJwAAABQP9UEZ1a4eEYejftNqhRpfPDxIU+/DrLFrEijj9b5G14eVvXI5uDNb4ZbelLrb9i9MjR97x3cEDJrXKXiJdvl87Ta+lSuNeK77//6cvfxwOJ9LE+tnOAU3ejiZapcudWyGWUOb3poZV4bW8my17doeLsfPwz4Zl1Ivy51xfKW7CwU2kO8NPEmmrpOP/PvRfGLUS8stekeTvHgbQ2TLZfkOXTkpCXmxUerV/85Fy/dSExMSk5O3rf/Rw8fG36uUhGcAAAAUD+nCk7RAOcvXJNqQYyjsb8VDuspW8ZaNLroQsGRg3vU+WRpsbitqRElfuHlZ84hT1/j5gXhsTEPVVbc1sAD60OWTi/TxVC/cHCEKEPLo+VAfu/oYyf+kF7p9z/+HV5hkHS7EoJTdHhYiXaDetRZP6/U4c3BcTEPrYzYLM/2r2kJzrLl2/zwQYB0+9aF4R2jGugKGUR2pu7n9O/UvO1LxcoOOHfuyoUL14qXG2h5ClsoGNDl2HHzJhXjr7/PaQt1EhVapFivDz85bDmtVIw///zPy7+j7MetjOAEAACA+jnXHk6vKGmfmBhxx34PLdXPFjvERAj5B0X26lRv5/Ji6btu/7oQcbu0TP6C0e9MKxv3cHBaHNsW+OX7RV8YUr1y5db6wgaRZ5YHzzr/0B6Xr9yQXqwYG7fskw43dVRwpiZiwWifgKh6dZpPH13p2w3BGddBIjZLV2N9yymvtWo2/25HanBKxMbZ8lZ4q2ZNvIukHo4rFigc1vNI7K9NWo+36cmT4rmmzlh3f1um7uFMSbk3e16MeMYS5Qf9/c/5+7ebx3/nrrQ3TbXpvtZUBCcAAADUT0HBqdGb8nsbc7nfT0Tmwnc+Gvvycu+grrK7ci/1ANpChqd71P52Q4hs76VwZHNQ+QptpCVFvYwbWu3Y/T2fjyIeIS4mUFTryP41Aou2z+7EQu4FjT/89I+5ge7du3s3oUqdEaKCxAYcNbDG9zsCjm8LTE/c0qyxTYJTvFjxpGXLtZnyXJW9a0JTt8wjSlsiQrRZ4yaWn23dvLGITNky4kE+W1bM0LaRuz71INv83lY+/TUj3+DuoiTNW/PevWMn/hDP6OIZ+c7ST6RbUlJSzp69/NrszUEleksn64oVc9WKD23qRzf9Q1kHwQkAAAD1U0pw+gdFrZxd+osVYctmlO0Q0UDrZ8zZfj/xNd1Na7DulRJFVwhVqraa+GwV0YcZU1Mioq5Jo6aWH+keXf9Ru/hk4rYGfrMu5P2ZZYb3rVWlSisvv6xWd+NW40+fST25URqffxnn4ZOaZyVKt21Yv1mD+s3TE7cUDjbvgM098SxiJQsWMdSv1/yFIdU3LQg/uDFYvBDZS8uU2FDVqrWSHkejM/XuVDfTXcHSdv7gnRIj+tcML91WPJ3tmtPLv9OOjw6at+O9ewcO/ly2ylBxu3jGwOK9GzQbW6fR86UqPq0v0ll8tKTXXiQ0on/XOuvnlfzy/bDZL1YUN6Z/QCsgOAEAAKB+SgnOhvWan9huzpW4mMCPlxTvFNUgIDT1qpvutth9lAVSQhQKimzUoNmiKeVTE+jhIpIR69+jQz3Lz9ar0+JRh9Q+yv19nkHbFxV/bkCN2rVaiJfv4WMUD/WomHHXG2s2HPX9D38nJiWJTEpISAop2Ve2jBVp7q+J6OHgYu2bNGw26dmqny8vKiLzUQX+KCe2BZYs01Z6TFetaczgGo/fsOLxD6wPnjaqco0aLe8fZ/tgYiFradJ6vNiASUnJp05fnP/Wdp9H7B4Xz+vhbSwa3m5wj9q7VqS+dmkNv1oZZjl912oITgAAAKifUoKzarVW0tQ7FiJC9q8LeWNi+cqVW4kssXpjPIabzqTRRVeq3GrO+Ir71oY+/gBRi2PbAkcPriE9gljb4iXbHtoYLFsmi8Rrj90S+O2G4JiFJcYMrl6jRitPP4OLV4dM93x6+Jh69J/z+x9nRS9Vqf2s7N7cc9OaXLxMPkUMIrwnj6zy4bvFD28KfnwiPpH0TwnSg899qYLs3kxJzyjS7qVh1UqUbpt+PtvcCy3V7/kXlzVr+7J3QNdMT87U6FIPnW1Qr/l7M0tnfFs/f6/o/7zlP5JbBCcAAADUTynB6RMQ9cWKMNn3eCEuJkh8v18/v+SogTXq1mmuL2QQ8Wm5hKO1iHS5H5mmoKIR7Vo2FlkVszD88ObgbO27i9saOGd8BctjevkZ96x+6MooOSMe9sjmoC/fL7p6dumpz1Xp2bFu/XrNw0q01/qnHnkrtob4r5vWWDCga416z3n5d7KsQHZp9KkPJbW92M7hpdo1a9x0QLc6r71QacMbJb9eFSaST/aPAjnzzboQ7yLmy2mKZ1w9u5RsgccTG2T/+pC1c0u/MKRak4bN/AIjRbWKx7G8kBxI/QCkHitrSc3UR0vdsDpToeDI5k2avjy82va3S4hnz/QjsWp2KTer74cnOAEAAKB+SglO0TnzXn7cni6RGce3Be5cVnTiiCptWzQuXrKdd+GoAj5G97RDPbN+gp9YWPoRD2+jzt8gIrNWzRairJZML3tgfch3OwKye4yoRPTY8tfKWOaP0eiiP15SXLZMLsXGpG6EEzsCRAx/urTY4lfLjn26uimiYcP6zUqXaxNSvL1/YGTBwgYvf4OHjzH//X1u0osVK5P637Sjc8VdYtNp/Q1iYRFUIl/LV2jdtFGzbqb6E0dUXTGr9K4VRY/GBH23PeDYtmwfMftEH75bXDy7tJXEOnyytJhsgSyKiwk8sS1AVP0bEyt0i65fqXKrwiGRWj/D/Vl8HrzYrBBLShtK/NrT1+gbGFm2fBtD24azX6woHl9s8MccHX1sa6B4F/5HcAIAAAAZKCU4NTpTZ0MD2QUbMyUdWnl4U9AX74etml3q5eFVI1o3LlmmrV9glId3dD6vDi6PIO7KXzDaNyCqeKm2rZo2GTWwhijMjxcX+3aD+QjJXB4mKmxdWMJyxulTBTpsmF9StoB1iRS0rPORzUEHNwbvXxciWnH72yXWzSv51uRyM8ZUHjuk+qAetbtG1+vZoe6QnrVeGFJ95thK70wrJ9btg3dLfPl+mGhs8YPix82PaY3t8BhinRe/UtbyvhcJifxmXYhsmeySVli8hAPrQj54p/iCyeWH9KrVuEGz4KLtvYtEiYxM96lIPTz4vgefCk+/6ELBUeUqtBGfwKmjKm9+M3zv6tDD9zdIVjaFCM46tVtYXpHVEJwAAABQP6UEp1C2QmvLvEFZJOpFfN0XRB7sXRO6c3mxLW+Fr3y99PIZZd55pdwbEyu8Nbn8O9PKLp1eVtwYs6DEZ8uK7VkdemhTsCjbY9sCxX+tG1c7lxeV9isK+Tw7LJxSTraAfaSGaEzqPuHUjXP/mijSf6VfiNvjtpqXkf2gHYhnF9FrOSi6YqXW1n0LpBcuXqn4hQjpr1eFfbK02KY3w1e9XnrJq2XFh+GNCRVEkYrkfn9WmdWzS29bWGLXe0VF9B65n45CdjfLp8uK6gpZc1ZkM4ITAAAA6qeg4CxYxLB3deqJgrIv9Cqyd01IwcLm9nDVmqY8V0W2AETOmSIaWA48bt2siWg82TLqMmNsJRcvax9PKxCcAAAAUD8FBae7PnraqCqqzo+DG0LCS7eVTh3U6KOH9q6dlYOE85Qjm4MqVmptObtyQPc6qn7H47YGGto2tPosVqkITgAAAKifsoKzYuVWhzfl8FIiCtG4QTNLfkS3a3h8G8H5kP3rQoqERlhmeJowoqpDjuy1luNbg8LTrilqZQQnAAAA1E9BwSm4ak0fLc7hnKVKINppQLe6lkt01KvTnOCU2bWiqGX3pvjFW5Mdc5qrVYi3O2ZhCU/fTK7baQUEJwAAANRPYcGpM80eXzFWtYehigKZ+UIl6eoaQvGSbWULYOvCcMsZj67aDuvmZe8inIoSFxPU3VTP8nZbGcEJAAAA9VNWcAqGtio+DDV2S9CGN0p6pF1k0jcg6suVYbJl8rhlM8paglOjM1n9UqX2tG9tSKHgSOm1WB/BCQAAAPVTXHAGhEaI7/Gyb/YqsndNqGWi2vwFoze9adtLcapLnLQHOO2Q4wK+xt2rQmXLqMjGN0q6as2vxfoITgAAAKif4oJTfIOfNa6S7Ju9isTGBIYUay+9FlFWc8ZXVPWFXqzr2LbA4X1rSRvHXR8dVrz9wQ1qnSPq2NbAkQNqWs5HtT6CEwAAAOqnuODU6KNbNm0St1X+/V4tvt8RUKlyK+m1uGlNz/SupepZWK3ru+2BxnYN095oU8P6zWQLqMihTcHlKrSWXotNEJwAAABQP8UFpxAYFnFks/z7vVqc2B7QrHFT6YWIeI5o1Sh2CxPVmh3bFlizRkvzxtGZhvaqFafaGl85q7Tl4i42QXACAABA/ZQYnPm9oxdMLq/SnZxxWwN7d3wwc2nVqi05pNbi8KbgYMvxxvrohVPKqTQ4xbvcLbqeDY+nFQhOAAAAqJ8Sg1N8j69Ro4V6d3KOG1rNMpdM0fB26n0hVvfZ0mJaf/OMSp6+xo8XF1fp8cYntgeUKtNWeiG2QnACAABA/ZQYnIKLV4ftb5eQfctXi0VTy1uu/OEXGPXNOhVPxGpdy2eUsaS4X2Ck7F61EJG8fl5JD+8HH1ebIDgBAACgfgoNTo3ONPbp6nFbVXn247ZFJdz15qzy9DN+vKSYbIE86+XhVS3BWaxku++2B8gWUItGDZppUt9i82uxCYITAAAA6qfQ4BQqVm59ZLMqr5mxZ3Wob2CU9CryF4x+Z1rZ2BjmDQo6GhPUPbqeW9pFOGvVbPn9DlUG50eLi+W39e5NgeAEAACA+ik3ON310Uunl5F911eF2JigChXNF8zQ6KOfH1TjmDp31VpX3NaghvWbWSbaad+y8fFt6tsscTFBk0dWdbfpvk0JwQkAAAD1U3BwFoxu17LxURVOKiM6ytCmkXTNDNFXLZo0Ve/FP6woLiawTLk20pur0Zme6aPKK5Qe2RxUpYotL79pQXACAABA/ZQbnEKh4Mi9q0Nk3/iV79jWwDGDa0gvQQRn0RLtv92gymODrevgpuAiIRHSZnHTmea+VEG2gCq8PbWcZSetbRGcAAAAUD9FB6f4Zj9mUHXVXZAzNibwnall81teiHf058uLypbJa2JjgnYuL6YrZL4minvB6M0LwmXLKN/xbYEtmjQhOAEAAIAsUnRwCj4BUV+vVt9lRbYsCLfMK+OqNa2bW0q2QF4TJyJ8WjnLNikcErlnjfre1m/Whlimg7I5ghMAAADqp/TgdPHqMOeliqo72e+LFWFaf/PePDet6fUXK6nxfEUrOrY1cHCP2pq0KWqrVm0pElS2jMKJd3BQ9zoau3UgwQkAAAD1U3pwCvXrNlfdBTkPrA8JDGtveQnD+9ZU6TVFrahmjRaWg1E7RTZQ3RS1X6wI8/Axr789EJwAAABQPxUEp/DOtHKyb/9KtzmoQb3mGr15h167Vo2/267Ka05ay77Ug1EjLTP3vvhMNXUV+LGtgS8Nq2anszclBCcAAADUTwXBKb7lN6zfPFZVR2DGxgQN71vLLe0I0goVWx9T29RH1vXhu8VcvMxbw01rWvJqWdkCCndgfXCpMuZrutgJwQkAAAD1U8ceTq2/8dNlaproVQTne6+VkXboCT4BUXtUOPWRFS2bUTafZwdpa7h6ddjxTgnZAgo39bkqrlpzMNsJwQkAAAD1U0dwuuujWzdvImsAhdu7JrRgYfO8QRp99Hszy8RmWCaPiNsaOGF4Vct0O1p/o7ry+/i2wIqVWksrbz8EJwAAANRPHcEpiFxZO7ekippNVEp4qXbSyrtpTWMGV8+zwSk2Rdfo+tKmcNdHlyvf5vCmYNkyihUXE7RgUgUPH6O0/vZDcAIAAED9VBOcQkSrRifUM7XpiR0BTRs2ldZco4tu17Kxuk5DtSIRnNWqtTRvCr2pV8d6KpoxaN/aEL/AKPtdDcWC4AQAAID6qSk4PX2Na+aUkvWAYsXFBPbvWscyUW3Z8m2ObJYvk0d8vTrUPyjK8j6++0q5OJVclVSs52tjK1kmf7IrghMAAADqp6bg1OijmzRqJksCJXvthUqWmWb8gyP3rQ2RLZBHrJhZxnJBkYKFo75eFSZbQLEOrA8pXc6+k9NaEJwAAABQPzUFp+DlZ9zyVrisChRry4Jwy6GYYs23LlTZ1KzWMmZwdUt4Fy/V7vh21RxP+9zAGvaenNaC4AQAAID6qSw4U6ecqdD6m3Xq2FX4zdqQwLAIy8q/8nwVtRxKal2tmzfWpB2V2qBes+NqOBE3dkvQtxtCQoq1t7x99kZwAgAAQP1UFpyCq9b06vOV49QwAc+xrYHNGzeVjibV6E2tmjWJzZPBWapsW+m9c9OaBnSto5bZevt0rms5EtgBCE4AAACon/qCUyhest3hzSq4rkbc1sAXn6kmRYt7weiA0Ihv1qrp+pNWsX9diG9gpPTGuXiZ5r9cQbaAIgVvXhCez9NBB9MCAAAAzkKVwanRmfp3rauKHWWrXi8tUlNabVetKWahak5AtYrYmKC1c0t7+Ji3gKev8ZOlxWTLKNCxrYFtmjd25O5NAAAAwCmoMjgFnyJRHy0upvwjVD9/r6inn1FaZxGcc8ZXlC3g3ES5PdO7tmXmpPIV2hzJsIwCvT6uooNq0/xRAQAAAJyDLYLTHl+aRQ/UrNlS+Ve2PLgxOLR4O8tq9+9W5/hW1czRmnuHNwWVK9/aEm9dDA2UP2PQkS3BRcMfvGUKQ5ECAABATdS6h1Nw05mmj6ms8J2csVuCoto00ujM61y7ZosT6rkoSO7tXF40v7f5tWv00bPGVVL4PL3i/erbpa60wgAAAAByScXBKRQv2e6rlWGyZlAU0cNzxlfS6M3Tz/gHRe5bq45ruuSeiLflM8rk8+wgvXaNzrTpzZKyZRRFrPCq10u7pV3BRZGYxwgAAABqou7gFA3TqlkTWTYoimiYr94PK1jYYF5hffS708rmkYujxMUEjhlU3XIFTl0hw+5Viv7XgaMxQVWqtpLWFgAAAEDuqTs4BU9f41uTy8cp+MTIY9sCK1ZqLa2tm87U1VhftoCzOrE9oHmTptILF9lZv25zJZ9zGxsTNKBbHWamBQAAAKxI9cEp+AVFKvliG3ExgZ0NDSxH1Zav0ObwJhVcRDT3vlkXEhAWIb1q8fKnPV85bqt8GYUQtbl1YbhlRzQAAAAAq3CG4HQvGN26eWMlT386Y0xlFy9zcPoGRO5ZHSpbwPmIhFs6o4wlswsWjvp6VahijyUW70hAaAS7NwEAAADrcobgFPJ7R48ZXF1WEcrxwTvFLZO1evhEL3m1rMIna7WGwN6d6lom4Clbvs132wMyLKMIIoO7GutTmwAAAIDVOUlwCrpChs0LwpW5D+3I5uAKlVq7319PETZdDfWPOfvVOI9sCbKcuSpesrFdo2OK3AUtPjCvjq78P9vWJhfPBAAAQB7lPMEpci6sRPs9a5R4tKrIyyE9a1nWs0hIxP51Tn5U7b61ob4BUdJLdvEyTX2uimwBhfjq/TC/wEhpPQEAAABYl/MEp6DRR0e3a6jAnZzSFSnzp62nq9a0Zk4p2TLOJG5r0MIp5SxHERfwMW5/u4RsGSX4amVYhYrmPc8AAAAArC73wamswwXd9dGjB9WQdYUSfLmiqGUSVDed6flBNZz4NE7R/K2aNbGcFVm9ekuR3LJlHE6sUqeoBu5p0xoBAAAAsDqn2sMp8fIzrplTSmk5d3hTcO2aLSw70xo1aHZih0In0cm9r1aGefk/uMTIC09XV9oJnCKJRw+qzkRBAAAAgE05YXAKRUIiNr0Zrqi9aqJwpj1fRZNWOH6BkbtXhsmWcRrvTivn4tVBeqWisTfML6mo9yIuJnDJq2ULFjafYgoAAADARpwzOIWKlVrvXRMiKw0HEsX19aow30Bz5LhpTZNHVlXg6aa5d2xbYJ/OdaVDVUVt+gdG7VXSTE5im6+fX9LLz8juTQAAAMDW1BucTzh3VARPzRotD20KlvWGA53YHlC7VgvL6tWp3eLwZvkyTiB2S3CZsm2kl+mmM0W2bixbwLH2rg4pWaattHo5wjmfAAAAQFY57R5OSYfIBgfWK2U/Z2xM0Ih+Nd205mLxDYz8yumOqo3dEvTezDKW+Wk9fKJXziqjnB25e9aE1qjRUqOzSjRSngAAAMATKCI4bXddClF3A7rVUc4EQhvfDLfUjqiyNyeWj9uqrNl0cq9TVIO0U1VNxUq2U8wLDP5mXUizxk2tdCStsiZnBgAAAJTJyfdwCvkLRg/rUzM2RhHZc2RLUKXKraUVE+VTv25zRc2mk3vfbggJLdEu7QWaOkQ0PKaM4Dy+LTCqTaOc1iZ5CQAAAOSE8wenUMDHOGFEVVmBOISorwnDq1pWLL939LZFJWTLqFdsTNDauaU8fc155qo1vTW5vGwZhzi0MbiLsQGzBAEAAAB2lieCU3DTmiY9W1UJ+zk/XlLcy+9Bkr0wpJrT7OSMiwk0tHuwFzGkWMT+dY4/gfbQpuDenevZ7rBtAAAAAI+iqOC07SwsBXyM45+pFhvj4HlrD20MrlyllaXKqtdoeXybk5zG+emyYh4+Dzb4kF61HP7Sjm0N7GpsoLl/jRYAAAAAdpZX9nBKPH2NE0dUdewexdiYoOljKqdNqxPt5Wfc9EZJ5czjmmNiq057vrJr2hy8ojwd/roObQruaqz/v7Qpc22AjgUAAAAeJ28Fp+CiNY0aWP3oFkfu5zy8KSikWHtpfdx0pqg2jY6o/4KccVuD6tZpLr0od310eOm2325w5PG0B9aHdIxoyL5NAAAAwIHyXHAKHj7GrtH1Hdh4x7cGdjHUtxxV6xcY+fUqdV+QM3ZL0Pr5JQukTRek0Zkmj6ziwN2bhzcFt2jSxF6zBDGHLQAAAJA5JwvObOzO6hzV4Ju1DtsFt2x6WTdt2sp4G6ePqaT2C3JGtW5k2Z0YFBbhqN2bonJ3vVe0Xt3mOa1Ny0eIjAQAAAByKy/u4ZS4aU2N6jf7Zm2oQ07pPLwpuFJl89RB7gWlA1AdPJtRbny9OtQvMErasOLldIps4JDpgkRtbl9UonjJdvbatwkAAADgcfJucEpKlGr34eLi9j/4My4mcO5LFfJ7m3ejuWhNb0xUxCUrcyBua9C4odUtm1Sji35/VmnZMnYg3sTlr5UJCI3gCigAAACAQuT14HTXRwcXb79wSrljdj+idc/q0CKhEebVKBjdvHFT+6+DVXy1Mky8ECnzxH/r12t+ZLO999Ye2Rw0ZWQVfSED+zYBAAAA5cjrwSnx8ImeMLzq4U3yjLG1Qd1ru+nMJw16+ho3vqm+66OIFZ74bBXLq/DwNi5+texR+74K8cZ1i67n4pWNM3htwLHPDgAAACgRwZnGO7pdy8b71obKYsam9q4OLRLyYCdnvTrNVXd9FBGcFSq2tryEouHt96+z33RBcVuDPlterFJl8woAAAAAUBSC8wGNzlSpcqs1c0rJqsZ2jm8L6t2pruUoUE9f46Y3wx0yiVHOiNqcNqpK+qNYXx1d2W47acWGmvNSxeBiEe4Kutgmc9sCAAAADxCcciKfJo+sKmsb29n+dnGPtKmDxFO3bNbkfnCq42TOAxuCi4W3S9t0xrLl2xzfbqc1/3ZDSO+O9TRWPmOTXAQAAACsieDMRH5vY4smTfeuDo3bKu8cq4uLCezRoZ5lJ6H4xZLp9j4HMmeObQ18ZXTl/N7mNXfTmSaMqGqH3ZvHtgVueKNkxUqtpWmKAAAAACgWwZk5jT46MKz9zHGVDm+y7YSrsVuCdi4v5pt2EUuhQb3mdgjd3Nu5vGih4EhL9ZUu23bvGpufAbt/XcjoQdV9AqLSH8cLAAAAQJnySHDm8FBJV62pTYsmB9aH2HTHnXjw7qb6loleRevOfami3c6EzJlj2wIH9aitSVtnkZ0LJpaPi7Hl8bQxQR8tLl6tWkvLkwIAAABQuMcEJ+ezpRIpVTgkcuKIqkdSz6u0VVDtWxsSVqK95UlDirXfs9qu8+Vm1453SvgGmPfKuutN5Sq0/na9DXcFi+bv16Wub6BadmySxAAAAEAqDqnNEo3e1LhBsw3zbXWdzLitQeOGVku/7+7pXrVlyyjHwY0hdWq3sEzYo/U3rny9tI22jHjYhVPKV6zcWqMzPx0AAAAAtSA4s8pdH53Ps8PAbnW+WWuL60wGHlgfUrJMW8sePDedacWsMke32PYM0hyIiwmaP6FC/rQd4GKFDW0bHt8WIFvMKj5fXrRFk6Zuug7qnB+IYwQAAACQ1xGc2SPKJ6R4+5eGVTu4MTjWqkfYxsYErZ1bytPXYHmiGtVbirqTLeZwO94unn6KI+8iUR++W1y2TC6JV/3t+uD+Xev4BUXa/hhashAAAACwFYIzJzQ6U/XqLRdMLn94U2ooynopx45sDopq28hyqKporQHd6ogbZYs5UGxMYJvmTTR686G/+QtGT36uStxWq4W3eKg9q0OnjqpcLLyd7VMTAAAAgG0RnDnnqjWVLtd23bxSVtwPeXBjcInS7SxPkd/buGp2aZF5ssUcQqzGmME1LLPpuutNVaq2OrTRagf9HtkS9M608kFhka5eTLrzGOySBQAAgGpkDE6+zmaDuz7ay99Yv16zJdPLih67v7czVwEWuyXozYnlRcpaniKoaPuPFlv5mNUcEC9NpLW+kPmIX6FISOQnS4qJFZYtmV0i18WDz3qhUqXKrfJ7mx/cudDPAAAAyKPYw2kF7nqTmy51Gtu3p5Y7uCE494eY9u5YL92DRzdp2OzwJgfPHvTxkuKph7mmrZVGZ5r0bG4Ppj22NfDr1aGvvVCpQqXW4gHVOTPQE0m1yb/jAAAAIC8iOK3JVduhWMl2C6eUu19iOY+xQxuDS5drawkwN63J0KaRA0/mFGVYp05zy0mVYsVM7RvkpjZjY4JEQk8ZWaVQcGT63bkAAAAAnAnBaWWiyvJ7G8PLtB3Wp9auFUWPb8thle14u0RQWMSDR/aOHj2oRtxW+WJ2cHhTUNsWjS1rIl5g6bJtvl4dKlssK2Lvt+sH7xbv0aFeSLH2Gn3qo1ke2alZ9nBS1wAAAMhDCE5bcdWaCgVHdjfVXzW71P71IdndHxgXE/jGxPKiMy0PKPJs8rNVRLDJlrSpw5uCB3WvnT4Lg4u2FzGcrbl5RWeKl7Nvbejb08q1a9nYy89omXnIQTjAFQAAALAHgtPm8nl2KBbe7vVxlUR6ZWuHp2jLSSOqpn+oAj7RCyZVyFbs5YZY2yG9amvSxaGLV4dFU8pnawVObA/8Zl3I6ME1ChY2MP0sAAAAkKcQnPZwfw+hKSA0ok3zxm9MqPDthhDRclnJtiObg/t0rps++Tx9jVOeq3os9dha204jdGRzULfo+gV8HuwM9PAxzhhTKSvT0oqXdnx76oRA00ZVqV+vuV9QlNgCTjonEAAAAIBHIjjtSnSXm84UVqJd/2513p9Veu/qUNFmjy/P2JjAjpENNfoHzSnK7flBNY7YMjj3rA7taqyf/khaUZ7D+tRMmwkp86eWXsiuFWELp5TrFNWgcEikm9ZZ554FAAAA8GQEp8OI8vQubOgWXW/bohIntgceSz3aNvMDbo9sDo5s3ViTLv/c9aaI1g1zfw3MjKQArl2rhXgKy9O5eJlG9K35qOOBxWqIu+JigkRCN2vc1MPHqNE9WFWkwxHFAAAAyFuyGJyPmmTFcvuDBdijlS0anamAj7FoeLuI1o1mjKm8a0XRuK2BGWcYOrgxuENEg/TNqdGbatVsEfNWeGxM5h2YA3Fbg5bPKFO8ZDvzvs37UxZ5+ESPebp6xguBipUUafrh4uIvD6vWtHHToKIR+b1TX45lDQEAAADkcezhVArReK5ak3cRQ4N6zV4cWm3t3FK7V4Ue3RIsdZ3UeH0615P9SJHQiDcmVDi0KTiXezvFj3+7IXjs09W9/B76xwV9YYNYGWkFxH/jYgJFeX6xIuy9maVH9K1ZrVpLTz+jK5GZPY/655v0jP9L948LAAAAgEoRnEqTGm8avcnVy+TlZ6hVs8WEEVU/W1rs2NbAY1tTe2/yyCr5010rRXDTmZo1brp7ZViOm1M07Y53ipco3Va2f9LDx/jOtHKxMeKpA0RtbltU4rkBNStWai1WQLSx2nZlZyXzlITgBAAAgPoRnIqm0UdrdNFaf0Pxku2aNW4yrE/NJa+WnT66ckix9ulPCBSBGhgW8Wz/WvvWhsalTmCbVSI1v1gR1t1U37uIIf0UQUK58m1Ebb45scLAbnUa1GsuntHT1yiKVLYYbOXBdmYHMgAAANSK4FQTEZYi+XwCokReZtzBKNK0dNk2c1+qmJqdT5j5NnVnqUjN8c9UKxQcmf7UUIvQ4u21fgY3nSnTe2FzbHYAAACoH8HpbESU+gVGvTS82sENISe2y+cTit0SdGJ7wN41oYO61/EuEuXO6ZeKRXACAABA/QhO5yTNJ9SkQbNhfWrNfrHishllFr9adubYSoO6165bu7koUvZbOtqTUv+Rb5DaTkYFAABAHkZwOjlXncnFM3UKIhfB0+SmU91kP3kV/yIAAAAA9SM4AQd69O5KghMAAADqR3A+kruOYxeVyF2f9fdFze8gwQkAAAD1IzgBAAAAADZBcAIAAAAAbILgBAAAAADYBMEJOBxXQwUAAIBzIjgBAAAAADZBcAIKwazIAAAAcDb2C073DLcANkC2AQAAAErBHk4AAAAAgE2oIjhNzKoCAAAAAKrDHk4AAAAAgE0QnICisDMfAAAAzoPgBAAAAADYBMEJKBBz7QIAAMAZEJxwAuQZAAAAoEQEJ6BMnMwJAAAA1SM4oWrs2wQAAACUi+AEAAAAANgEwQkAAAAAsAmCEwAAAABgEwQnAAAAAMAmCE4AAAAAgE0QnAAAAAAAmyA4AQAAAAA2QXACAAAAAGyC4AQAAAAA2ATBCQAAAACwCYITAAAAAGADBaP/H8Mc8nXb0rggAAAAAElFTkSuQmCC"
  alt="MariaBeatriz" style="width:100%">
  </figure>
  
  
    </div>
  <div class="content">
    <div class="cards">
      <div class="card cond">
        <h4> <i class="fas fa-podcast"></i> 
             CONDUTIVIDADE</h4><p>
             <span class="reading">
             <span id="co">
             </span> ppm</span>
             </p>
             <p class="packet"> Qualidade: <span id="qwco"></span></p>
      </div>
      <div class="card turb">
        <h4><i class="fas fa-binoculars"></i> 
            TURBIDEZ</h4><p>
            <span class="reading">
            <span id="tu">
            </span> NDU</span>
            </p>
             <p class="packet"> Qualidade: <span id="qwtu"></span></p>
      </div>
      <div class="card Temp">
        <h4><i class="fas fa-thermometer-half"></i> 
        TEMPERATURA</h4><p>
        <span class="reading"><span id="te">
        </span> &deg;C</span>
        </p>
      </div>
      <div class="card Qual">
        <h4><i class="fas fa-tint"></i> 
        QUALIDADE</h4><p>
        <span class="reading"><span id="qw">
        </span> &percnt;</span>
        </p>
      </div>
    </div>
  </div>
<script>

if (!!window.EventSource) {
  var source = new EventSource('/events');
  
  source.addEventListener('open', function(e) {
    console.log("Events Connected");
  }, false);

  source.addEventListener('error', function(e) {
    if (e.target.readyState != EventSource.OPEN) {
      console.log("Events Disconnected");
    }
  }, false);
  
  source.addEventListener('message', function(e) {
    console.log("message", e.data);
  }, false);
  
  source.addEventListener('new_readings', function(e) {
    console.log("new_readings", e.data);
    var obj = JSON.parse(e.data);
    document.getElementById("tu").innerHTML = obj.turb.toFixed(2)
    document.getElementById("te").innerHTML = obj.temp.toFixed(2);
    document.getElementById("co").innerHTML = obj.cond.toFixed(2);
    document.getElementById("qw").innerHTML = obj.qual.toFixed(2);
    document.getElementById("qwtu").innerHTML = obj.qualtu.toFixed(2);
    document.getElementById("qwco").innerHTML = obj.qualco.toFixed(2);
  }, false);
}
</script>
</body>
</html>

)rawliteral";  


//################################ 
void initWiFi() {

  // Connect to Wi-Fi network with SSID and password
  Serial.print("Connecting to ");
  Serial.println(ssid);

  // Set the device as a Station and Soft Access Point simultaneously
  WiFi.mode(WIFI_AP_STA);

  WiFi.begin(ssid, password);
  while (WiFi.status() != WL_CONNECTED) {
    delay(500);
    Serial.print("Setting as a Wi-Fi Station..");
  }
  // Print local IP address and start web server
  Serial.println("");
  Serial.println("WiFi connected.");
  Serial.println("IP address: ");
  Serial.println(WiFi.localIP());
  Serial.print("Wi-Fi Channel: ");
  Serial.println(WiFi.channel());


  server.on("/", HTTP_GET, [](AsyncWebServerRequest *request){
    request->send_P(200, "text/html", index_html);
  });
   
  events.onConnect([](AsyncEventSourceClient *client){
    if(client->lastId()){
      Serial.printf("Client reconnected! Last message ID that it got is: %u\n", client->lastId());
    }
    // send event with message "hello!", id current millis
    // and set reconnect delay to 1 second
    client->send("hello!", NULL, millis(), 10000);
  });
  server.addHandler(&events);
  server.begin();

}
 
void TaskInternetManager ( void * pvParameters ){
  char buf[15];
  static unsigned long lastEventTime = millis();
  static const unsigned long EVENT_INTERVAL_MS = 5000;

  //for(;;){
    if ((millis() - lastEventTime) > EVENT_INTERVAL_MS) {
      events.send("ping",NULL,millis());
      lastEventTime = millis();
    }
  //}
}

uint8_t readmsg(void ){
  uint8_t count=0, i=0; 
  uint8_t lenmsg=0;
  uint8_t readbyte;
  uint16_t u16Aux;
  float fAux;
  uint8_t *pu8Aux;
  uint8_t pos=0;

  //read header
  readbyte = Serial2.read();
  if (readbyte == HEADER_MSG){
      pos++;
      //Read Voltage Turbidez
      pu8Aux = (uint8_t *)&fAux;
      *pu8Aux++ = Serial2.read();
      *pu8Aux++ = Serial2.read();
      *pu8Aux++ = Serial2.read();
      *pu8Aux++ = Serial2.read();
      inputframe.turb_v = fAux;
      pos+=4;
      //Read NTU Turbidez
      pu8Aux = (uint8_t *)&fAux;
      *pu8Aux++ = Serial2.read();
      *pu8Aux++ = Serial2.read();
      *pu8Aux++ = Serial2.read();
      *pu8Aux++ = Serial2.read();
      inputframe.turb_ntu = fAux;
      pos+=4;
      //read temperature sensor
      pu8Aux = (uint8_t *)&fAux;
      *pu8Aux++ = Serial2.read();
      *pu8Aux++ = Serial2.read();
      *pu8Aux++ = Serial2.read();
      *pu8Aux++ = Serial2.read();
      inputframe.temp = fAux;
      pos+=4;
      //read voltage condutivity
      pu8Aux = (uint8_t *)&fAux;
      *pu8Aux++ = Serial2.read();
      *pu8Aux++ = Serial2.read();
      *pu8Aux++ = Serial2.read();
      *pu8Aux++ = Serial2.read();
      inputframe.cond_v = fAux;
      pos+=4;
      //read tds condutivity
      pu8Aux = (uint8_t *)&fAux;
      *pu8Aux++ = Serial2.read();
      *pu8Aux++ = Serial2.read();
      *pu8Aux++ = Serial2.read();
      *pu8Aux++ = Serial2.read();
      inputframe.cond_tds = fAux;
      pos+=4;
      //read footer
      pu8Aux = (uint8_t *)&u16Aux;
      *pu8Aux++ = Serial2.read();
      *pu8Aux++ = Serial2.read();
      inputframe.footer = u16Aux;
      pos+=2;      

      if (inputframe.footer == FOOTER_MSG)
        return pos;
      else
        Serial.println("error RX message!!!");
  }
  return 0;
}


void readloop(){

   float turb_qual;
   float cond_qual;
   float ang,aux2;

    while (Serial2.available()) {
      
      if ( readmsg() > 0){
       
        //Water Quality Indicator in Percentage
        ang = (float) (-100.0)/(TURB_NTU_MAX - TURB_NTU_MIN);
        turb_qual = ang * (inputframe.turb_ntu - TURB_NTU_MAX);
        if (turb_qual >100)
            turb_qual =100.0;
        if (turb_qual < 0.0)
            turb_qual = 0.0;    
        ang = (float) (-100.0)/(TURB_TDS_MAX - TURB_TDS_MIN);
        cond_qual = ang * (inputframe.cond_tds - TURB_TDS_MAX);
        if (cond_qual > 100)
            cond_qual = 100.0;
        if (cond_qual < 0.0)
            cond_qual = 0.0;    
        
        fwaterquality = (turb_qual + cond_qual)/2;

        #if IMPRIME_SERIAL
          Serial.print("Turbidez: V= ");
          Serial.print(inputframe.turb_v);
          Serial.print(" NTU= ");
          Serial.print(inputframe.turb_ntu);
          Serial.print(" - Condutividade: V= ");
          Serial.print(inputframe.cond_v);
          Serial.print(" Tds= ");
          Serial.print(inputframe.cond_tds);
          Serial.print(" - Temperatura =");
          Serial.print(inputframe.temp);
          Serial.print(" - Qualidade ");
          Serial.print(" turb =");
          Serial.print(turb_qual);
          Serial.print(" cond =");
          Serial.print(cond_qual);
          Serial.print(" média_qual =");
          Serial.println(fwaterquality);
        #endif 

        board["turb"] = inputframe.turb_ntu;
        board["temp"] = inputframe.temp;
        board["cond"] = inputframe.cond_tds;
        board["qual"] = fwaterquality;
        board["qualtu"] = turb_qual;
        board["qualco"] = cond_qual;

        String jsonString = JSON.stringify(board);
        events.send(jsonString.c_str(), "new_readings", millis());       
        count++;       
      } 
       
  }
}


void TaskSerialManager ( void * pvParameters ){
 
  for(;;){
    if (blinkvalue)
      blinkvalue = 0;
    else
      blinkvalue = 1;
    
    digitalWrite(LED_BUILTIN, blinkvalue); 

    readloop();

    delay(1000);
  }
  
  vTaskDelete( NULL );
  
}
 
// Initialize device.
void setup() {
  Serial.begin(115200);
  Serial2.begin(9600, SERIAL_8N1, RXp2, TXp2);
  
  // initialize digital LED_BUILTIN on pin 13 as an output.
  pinMode(LED_BUILTIN, OUTPUT);

  initWiFi();

  //xTaskCreatePinnedToCore( TaskInternetManager, "TaskInternetManager", PRJ_DEFAULT_STACK_SIZE, NULL, 1, &TaskInternetManagerHandle, 0);          /* pin task to core 0 */
  xTaskCreate( TaskSerialManager, "TaskSerialManager", 10000, NULL, 1, &TaskSerialManagerHandle);

//  vTaskDelete(NULL);
}
 
void loop() {
   int parameters = 0;
   TaskInternetManager(&parameters);
}
 
 
 
